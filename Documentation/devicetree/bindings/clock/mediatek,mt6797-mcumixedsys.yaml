## Documentation/devicetree/bindings/clock/mediatek,mt6797-mcumixedsys.yaml
```yaml
# SPDX-License-Identifier: (GPL-2.0-only OR BSD-2-Clause)
%YAML 1.2
---
$id: http://devicetree.org/schemas/clock/mediatek,mt6797-mcumixedsys.yaml#
$schema: http://devicetree.org/meta-schemas/core.yaml#

title: MediaTek MT6797 CPU clock controller

maintainers:
  - Matthias Brugger <matthias.bgg@gmail.com>

description: |
  The MT6797 MCUMIXEDSYS block contains the clock muxes and dividers for the
  three CPU clusters and the coherent interconnect. It also contains the
  PLLs for the two Cortex-A53 clusters and the interconnect.

  The Cortex-A72 cluster PLL is controlled by secure firmware instead of
  MCUMIXEDSYS MMIO. The controller is nevertheless the single owner of each
  complete CPU clock path: its secure PLL, MCUMIXEDSYS mux and divider, and
  the CSPM hardware semaphore which serializes MCUMIXEDSYS access with
  firmware. Secure-firmware details are implied by the SoC compatible and
  are not a device-tree policy choice.

properties:
  compatible:
    const: mediatek,mt6797-mcumixedsys

  reg:
    items:
      - description: MCUMIXEDSYS registers
      - description: CSPM registers containing the hardware semaphore
      - description: MCUCFG registers containing the synchronous DCM control

  reg-names:
    items:
      - const: mcumixed
      - const: cspm
      - const: mcucfg

  clocks:
    items:
      - description: 26 MHz reference and safe clock source
      - description: MAINPLL intermediate clock source
      - description: UNIVPLL intermediate clock source
      - description: I2C_APPM clock required while using the CSPM semaphore

  clock-names:
    items:
      - const: clk26m
      - const: mainpll
      - const: univpll
      - const: i2c

  '#clock-cells':
    const: 1

required:
  - compatible
  - reg
  - reg-names
  - clocks
  - clock-names
  - '#clock-cells'

additionalProperties: false

examples:
  - |
    #include <dt-bindings/clock/mt6797-clk.h>

    clock-controller@1001a000 {
        compatible = "mediatek,mt6797-mcumixedsys";
        reg = <0x1001a000 0x1000>, <0x11015000 0x1000>,
              <0x10220000 0x1000>;
        reg-names = "mcumixed", "cspm", "mcucfg";
        clocks = <&clk26m>,
                 <&apmixedsys CLK_APMIXED_MAINPLL>,
                 <&apmixedsys CLK_APMIXED_UNIVPLL>,
                 <&infrasys CLK_INFRA_I2C_APPM>;
        clock-names = "clk26m", "mainpll", "univpll", "i2c";
        #clock-cells = <1>;
    };
```

## Documentation/devicetree/bindings/clock/mediatek,mt6797-seninf-mclk.yaml
```yaml
# SPDX-License-Identifier: (GPL-2.0-only OR BSD-2-Clause)
%YAML 1.2
---
$id: http://devicetree.org/schemas/clock/mediatek,mt6797-seninf-mclk.yaml#
$schema: http://devicetree.org/meta-schemas/core.yaml#

title: MediaTek MT6797 SENINF camera sensor master clocks

maintainers:
  - George Whewell <georgerw@gmail.com>

description:
  The timing generators of the MT6797 sensor interface (SENINF) drive the
  CMMCLKn pads that clock external camera sensors. Clock specifier n
  selects the timing generator of SENINF instance n, which is 0x1000 * n
  bytes after the start of the register window.

properties:
  compatible:
    const: mediatek,mt6797-seninf-mclk

  reg:
    maxItems: 1

  clocks:
    items:
      - description: CAMTG gate, the source of the sensor clocks
      - description: SENINF register gate
      - description: CAMSYS gate

  clock-names:
    items:
      - const: camtg
      - const: seninf
      - const: camsys

  power-domains:
    maxItems: 1

  '#clock-cells':
    const: 1

required:
  - compatible
  - reg
  - clocks
  - clock-names
  - power-domains
  - '#clock-cells'

additionalProperties: false

examples:
  - |
    #include <dt-bindings/clock/mt6797-clk.h>
    #include <dt-bindings/power/mt6797-power.h>

    clock-controller@1a040000 {
        compatible = "mediatek,mt6797-seninf-mclk";
        reg = <0x1a040000 0x2000>;
        clocks = <&camsys CLK_CAM_CAMTG>, <&camsys CLK_CAM_SENINF>,
                 <&camsys CLK_CAM_CAMSYS>;
        clock-names = "camtg", "seninf", "camsys";
        power-domains = <&scpsys MT6797_POWER_DOMAIN_ISP>;
        #clock-cells = <1>;
    };
```

## Documentation/devicetree/bindings/display/panel/planet,gemini-pda-nt36672.yaml
```yaml
# SPDX-License-Identifier: GPL-2.0-only OR BSD-2-Clause
%YAML 1.2
---
$id: http://devicetree.org/schemas/display/panel/planet,gemini-pda-nt36672.yaml#
$schema: http://devicetree.org/meta-schemas/core.yaml#

title: Planet Gemini PDA NT36672 DSI Panel

maintainers:
  - Julien Etienne <julien.etienne@gmail.com>

description: |
  This is the 1080x2160 DSI panel described by the Planet vendor LCM source
  drivers/misc/mediatek/lcm/aeon_nt36672_fhd_dsi_vdo_x600_xinli/
  aeon_nt36672_fhd_dsi_vdo_x600_xinli.c.  The panel has two board-specific
  display-bias supplies, and its reset sequence is supplied by reset-gpios.
  The recovered source does not identify a physical panel module, active-area
  dimensions, or the bias-output voltages; those facts are intentionally not
  represented by this binding.

allOf:
  - $ref: panel-common.yaml#

properties:
  compatible:
    const: planet,gemini-pda-nt36672

  reg:
    maxItems: 1
    description: DSI virtual channel

  outp-supply: true
  outn-supply: true
  reset-gpios: true
  backlight: true
  port: true

required:
  - compatible
  - reg
  - outp-supply
  - outn-supply
  - reset-gpios
  - port

additionalProperties: false
```

## Documentation/devicetree/bindings/dma/mediatek,mt6765-cqdma.yaml
```yaml
# SPDX-License-Identifier: (GPL-2.0-only OR BSD-2-Clause)
%YAML 1.2
---
$id: http://devicetree.org/schemas/dma/mediatek,mt6765-cqdma.yaml#
$schema: http://devicetree.org/meta-schemas/core.yaml#

title: MediaTek Command-Queue DMA Controller

maintainers:
  - Matthias Brugger <matthias.bgg@gmail.com>

description:
  The MediaTek Command-Queue DMA (CQDMA) controller provides multiple virtual
  DMA channels backed by a small number of physical memcpy engines.

properties:
  compatible:
    enum:
      - mediatek,mt6765-cqdma
      - mediatek,mt6797-cqdma

  reg:
    minItems: 2
    maxItems: 3

  interrupts:
    minItems: 2
    maxItems: 3

  clocks:
    maxItems: 1

  clock-names:
    const: cqdma

  "#dma-cells":
    const: 1
    description: Virtual DMA channel number

  dma-channels:
    minimum: 2
    maximum: 3

  dma-requests:
    minimum: 1
    maximum: 32

required:
  - compatible
  - reg
  - interrupts
  - clocks
  - clock-names
  - "#dma-cells"
  - dma-channels

additionalProperties: false

allOf:
  - $ref: dma-controller.yaml#
  - if:
      properties:
        compatible:
          contains:
            const: mediatek,mt6797-cqdma
    then:
      properties:
        reg:
          minItems: 2
          maxItems: 2
        interrupts:
          minItems: 2
          maxItems: 2
        dma-channels:
          const: 2

examples:
  - |
    #include <dt-bindings/clock/mt6797-clk.h>
    #include <dt-bindings/interrupt-controller/arm-gic.h>
    #include <dt-bindings/interrupt-controller/irq.h>

    dma-controller@10212c00 {
        compatible = "mediatek,mt6797-cqdma";
        reg = <0x10212c00 0x100>,
              <0x10212d00 0x100>;
        interrupts = <GIC_SPI 118 IRQ_TYPE_LEVEL_LOW>,
                     <GIC_SPI 119 IRQ_TYPE_LEVEL_LOW>;
        clocks = <&infrasys CLK_INFRA_GCE>;
        clock-names = "cqdma";
        dma-channels = <2>;
        dma-requests = <32>;
        #dma-cells = <1>;
    };
```

## Documentation/devicetree/bindings/dma/mediatek,mt6797-hif-dma.yaml
```yaml
# SPDX-License-Identifier: (GPL-2.0-only OR BSD-2-Clause)
%YAML 1.2
---
$id: http://devicetree.org/schemas/dma/mediatek,mt6797-hif-dma.yaml#
$schema: http://devicetree.org/meta-schemas/core.yaml#

title: MediaTek MT6797 HIF peripheral DMA controller

maintainers:
  - Matthias Brugger <matthias.bgg@gmail.com>

description:
  The MT6797 HIF DMA controller is a single-channel peripheral DMA engine.
  It transfers one contiguous buffer between memory and the memory-mapped
  data port of the connectivity HIF.

allOf:
  - $ref: dma-controller.yaml#

properties:
  compatible:
    const: mediatek,mt6797-hif-dma

  reg:
    maxItems: 1

  interrupts:
    maxItems: 1

  clocks:
    maxItems: 1

  clock-names:
    const: apdma

  "#dma-cells":
    const: 1
    description: The cell must contain zero, the only hardware channel ID.

  dma-channels:
    const: 1

required:
  - compatible
  - reg
  - interrupts
  - clocks
  - clock-names
  - "#dma-cells"
  - dma-channels

additionalProperties: false

examples:
  - |
    #include <dt-bindings/clock/mt6797-clk.h>
    #include <dt-bindings/interrupt-controller/arm-gic.h>
    #include <dt-bindings/interrupt-controller/irq.h>

    dma-controller@11000080 {
        compatible = "mediatek,mt6797-hif-dma";
        reg = <0x11000080 0x80>;
        interrupts = <GIC_SPI 97 IRQ_TYPE_LEVEL_LOW>;
        clocks = <&infrasys CLK_INFRA_AP_DMA>;
        clock-names = "apdma";
        dma-channels = <1>;
        #dma-cells = <1>;
    };
```

## Documentation/devicetree/bindings/gnss/mediatek,mt6797-consys-gnss.yaml
```yaml
# SPDX-License-Identifier: (GPL-2.0-only OR BSD-2-Clause)
%YAML 1.2
---
$id: http://devicetree.org/schemas/gnss/mediatek,mt6797-consys-gnss.yaml#
$schema: http://devicetree.org/meta-schemas/core.yaml#

title: MediaTek MT6797 integrated GNSS receiver

maintainers:
  - George Whewell <georgerw@gmail.com>

description: |
  The MT6797 connectivity subsystem carries its integrated GNSS byte stream on
  channel two of the internal full-STP transport. A shared CONSYS controller
  owns that transport and its firmware lifecycle. This node owns only the GNSS
  function lifetime and the board antenna low-noise-amplifier supply.

allOf:
  - $ref: gnss-common.yaml#

properties:
  compatible:
    const: mediatek,mt6797-consys-gnss

  mediatek,controller:
    $ref: /schemas/types.yaml#/definitions/phandle
    description: CONSYS controller which owns the active full-STP session.

  lna-supply: true

required:
  - compatible
  - mediatek,controller
  - lna-supply

unevaluatedProperties: false

examples:
  - |
    gnss {
        compatible = "mediatek,mt6797-consys-gnss";
        mediatek,controller = <&consys_controller>;
        lna-supply = <&gnss_lna>;
        status = "disabled";
    };
...
```

## Documentation/devicetree/bindings/gnss/mediatek,mt6797-gnss.yaml
```yaml
# SPDX-License-Identifier: (GPL-2.0-only OR BSD-2-Clause)
%YAML 1.2
---
$id: http://devicetree.org/schemas/gnss/mediatek,mt6797-gnss.yaml#
$schema: http://devicetree.org/meta-schemas/core.yaml#

title: MediaTek MT6797 CONSYS GNSS function

maintainers:
  - George Whewell <georgerw@gmail.com>

description: |
  GNSS STP task 2 of the MT6797 connectivity subsystem. The parent owns
  shared power, firmware, WMT transactions and transport. The child owns
  its optional antenna LNA supply and exposes the unmodified receiver byte
  stream using the Linux GNSS character-device interface.

allOf:
  - $ref: gnss-common.yaml#

properties:
  compatible:
    const: mediatek,mt6797-gnss
  lna-supply: true

required:
  - compatible

unevaluatedProperties: false
```

## Documentation/devicetree/bindings/input/gpio-matrix-keypad.yaml
```yaml
# SPDX-License-Identifier: (GPL-2.0-only OR BSD-2-Clause)
%YAML 1.2
---

$id: http://devicetree.org/schemas/input/gpio-matrix-keypad.yaml#
$schema: http://devicetree.org/meta-schemas/core.yaml#

title: GPIO matrix keypad

maintainers:
  - Marek Vasut <marek.vasut@gmail.com>

description:
  GPIO driven matrix keypad is used to interface a SoC with a matrix keypad.
  The matrix keypad supports multiple row and column lines, a key can be
  placed at each intersection of a unique row and a unique column. The matrix
  keypad senses key press and release through the row and column GPIO lines,
  then reports events using interrupts or periodic polling.

allOf:
  - $ref: input.yaml#
  - $ref: /schemas/input/matrix-keymap.yaml#

  - if:
      required:
        - poll-interval
    then:
      properties:
        wakeup-source: false

properties:
  compatible:
    const: gpio-matrix-keypad

  row-gpios:
    description:
      List of GPIOs used as row lines. The gpio specifier for this property
      depends on the gpio controller to which these row lines are connected.

  col-gpios:
    description:
      List of GPIOs used as column lines. The gpio specifier for this property
      depends on the gpio controller to which these column lines are connected.

  linux,keymap: true

  linux,no-autorepeat:
    type: boolean
    description: Do not enable autorepeat feature.

  gpio-activelow:
    type: boolean
    description:
      Force GPIO polarity to active low.
      In the absence of this property GPIOs are treated as active high.

  debounce-delay-ms: true

  col-scan-delay-us:
    description:
      Delay, measured in microseconds, that is needed
      before we can scan keypad after activating column gpio.
    default: 0

  all-cols-on-delay-us:
    description:
      Delay, measured in microseconds, that is needed
      after activating all column gpios.
    default: 0

  poll-interval:
    $ref: /schemas/types.yaml#/definitions/uint32
    minimum: 1
    description:
      Poll interval in milliseconds. When present, scan the matrix at this
      interval instead of requesting interrupts for the row GPIOs. Polling
      cannot wake a suspended system.

  drive-inactive-cols:
    type: boolean
    description:
      Drive inactive columns during scan,
      default is to turn inactive columns into inputs.

  wakeup-source: true

required:
  - compatible
  - row-gpios
  - col-gpios
  - linux,keymap

additionalProperties: false

examples:
  - |
    matrix-keypad {
        compatible = "gpio-matrix-keypad";
        debounce-delay-ms = <5>;
        col-scan-delay-us = <2>;

        row-gpios = <&gpio2 25 0
                     &gpio2 26 0
                     &gpio2 27 0>;

        col-gpios = <&gpio2 21 0
                     &gpio2 22 0>;

        linux,keymap = <0x0000008B
                        0x0100009E
                        0x02000069
                        0x0001006A
                        0x0101001C
                        0x0201006C>;

        wakeup-source;
    };
```

## Documentation/devicetree/bindings/input/touchscreen/novatek,nt36xxx.yaml
```yaml
# SPDX-License-Identifier: (GPL-2.0-only OR BSD-2-Clause)
%YAML 1.2
---
$id: http://devicetree.org/schemas/input/touchscreen/novatek,nt36xxx.yaml#
$schema: http://devicetree.org/meta-schemas/core.yaml#

title: Novatek legacy NT36xxx touchscreen controller

maintainers:
  - Julien Etienne <julien.etienne@gmail.com>

description: |
  This controller uses I2C address 0x62 for hardware commands and address
  0x01 as an alternate target for firmware and xdata accesses. The driver
  reads a trim identifier during probe and rejects values not in its supported
  table; the compatible therefore denotes the protocol family, not a specific
  controller revision.

allOf:
  - $ref: touchscreen.yaml#

properties:
  compatible:
    const: novatek,nt36xxx

  reg:
    const: 0x62

  interrupts:
    maxItems: 1

required:
  - compatible
  - reg
  - interrupts

unevaluatedProperties: false

examples:
  - |
    #include <dt-bindings/interrupt-controller/irq.h>
    i2c {
        #address-cells = <1>;
        #size-cells = <0>;

        touchscreen@62 {
            compatible = "novatek,nt36xxx";
            reg = <0x62>;
            interrupt-parent = <&gpio>;
            interrupts = <8 IRQ_TYPE_EDGE_RISING>;
        };
    };
...
```
