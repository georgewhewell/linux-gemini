## Documentation/devicetree/bindings/regulator/dlg,da9211.yaml
```yaml
# SPDX-License-Identifier: (GPL-2.0 OR BSD-2-Clause)
%YAML 1.2
---
$id: http://devicetree.org/schemas/regulator/dlg,da9211.yaml#
$schema: http://devicetree.org/meta-schemas/core.yaml#

title:
  Dialog Semiconductor DA9211-9215, DA9223-9225 Voltage Regulators

description:
  The DA9214 exists with two incompatible register interfaces. The
  dlg,da9214 compatible selects the paged interface with an identification
  register, while dlg,da9214-legacy selects the older direct-address
  interface. The latter exposes application pages 0 and 1 at the primary
  address and pages 2 and 3 at the adjacent page2 address.

maintainers:
  - Ariel D'Alessandro <ariel.dalessandro@collabora.com>

properties:
  compatible:
    enum:
      - dlg,da9211
      - dlg,da9212
      - dlg,da9213
      - dlg,da9214
      - dlg,da9214-legacy
      - dlg,da9215
      - dlg,da9223
      - dlg,da9224
      - dlg,da9225

  reg:
    minItems: 1
    items:
      - description: Primary register address.
      - description: Legacy page2 register address.

  reg-names:
    minItems: 2
    maxItems: 2

  interrupts:
    maxItems: 1

  regulators:
    type: object
    additionalProperties: false
    description:
      List of regulators provided by the device

    patternProperties:
      "^BUCK([AB])$":
        type: object
        $ref: regulator.yaml#
        unevaluatedProperties: false
        description:
          Properties for a single BUCK regulator

        properties:
          regulator-initial-mode:
            items:
              enum: [ 1, 2, 3 ]
            description:
              Defined in include/dt-bindings/regulator/dlg,da9211-regulator.h

          regulator-allowed-modes:
            items:
              enum: [ 1, 2, 3 ]
            description:
              Defined in include/dt-bindings/regulator/dlg,da9211-regulator.h

          enable-gpios:
            maxItems: 1

required:
  - compatible
  - reg
  - regulators

allOf:
  - if:
      properties:
        compatible:
          const: dlg,da9214-legacy
    then:
      properties:
        reg:
          minItems: 2
          maxItems: 2
        reg-names:
          items:
            - const: primary
            - const: page2
        interrupts: false
        regulators:
          required:
            - BUCKA
            - BUCKB
      required:
        - reg-names
    else:
      properties:
        reg:
          maxItems: 1
        reg-names: false

additionalProperties: false

examples:
  - |
    #include <dt-bindings/regulator/dlg,da9211-regulator.h>

    i2c {
        #address-cells = <1>;
        #size-cells = <0>;

        regulator@68 {
            compatible = "dlg,da9212";
            reg = <0x68>;
            interrupts = <3 27>;

            regulators {
                BUCKA {
                    regulator-name = "VBUCKA";
                    regulator-min-microvolt = < 300000>;
                    regulator-max-microvolt = <1570000>;
                    regulator-min-microamp = <2000000>;
                    regulator-max-microamp = <5000000>;
                    enable-gpios = <&gpio 27 0>;
                };
                BUCKB {
                    regulator-name = "VBUCKB";
                    regulator-min-microvolt = < 300000>;
                    regulator-max-microvolt = <1570000>;
                    regulator-min-microamp = <2000000>;
                    regulator-max-microamp = <5000000>;
                    enable-gpios = <&gpio 17 0>;
                };
            };
        };
    };

  - |
    i2c {
        #address-cells = <1>;
        #size-cells = <0>;

        regulator@68 {
            compatible = "dlg,da9214-legacy";
            reg = <0x68>, <0x69>;
            reg-names = "primary", "page2";

            regulators {
                BUCKA {
                    regulator-name = "VBUCKA";
                };

                BUCKB {
                    regulator-name = "VBUCKB";
                };
            };
        };
    };

...
```

## Documentation/devicetree/bindings/regulator/dlg,da9213-legacy.yaml
```yaml
# SPDX-License-Identifier: (GPL-2.0 OR BSD-2-Clause)
%YAML 1.2
---
$id: http://devicetree.org/schemas/regulator/dlg,da9213-legacy.yaml#
$schema: http://devicetree.org/meta-schemas/core.yaml#

title: Dialog Semiconductor DA9213-DA9215 legacy direct-address regulators

maintainers:
  - Julien Etienne <julien.etienne@gmail.com>

description:
  The legacy DA9213, DA9214, and DA9215 interface exposes its primary and
  secondary register banks at fixed I2C addresses.  This binding is distinct
  from dlg,da9211.yaml, whose driver selects paged registers through PAGE_CON.
  A regulators child describes the physical outputs. Boards must keep the
  device disabled until the direct-address transport and rail constraints
  have been validated for that board.

properties:
  compatible:
    enum:
      - dlg,da9213-legacy
      - dlg,da9214-legacy
      - dlg,da9215-legacy

  reg:
    items:
      - description:
          Primary register-bank address. The legacy interface fixes this at
          0x68.
      - description:
          Secondary register-bank address. The legacy interface fixes this at
          0x69.

  reg-names:
    items:
      - const: primary
      - const: page2

  interrupts:
    maxItems: 1

  regulators:
    type: object
    additionalProperties: false
    description:
      Physical buck outputs registered with the regulator core.

    patternProperties:
      "^BUCK[AB]$":
        type: object
        $ref: regulator.yaml#
        unevaluatedProperties: false
        description:
          Properties for one physical buck output.

        properties:
          regulator-initial-mode:
            items:
              enum: [ 1, 2, 3 ]
            description:
              Defined in include/dt-bindings/regulator/dlg,da9211-regulator.h

          regulator-allowed-modes:
            items:
              enum: [ 1, 2, 3 ]
            description:
              Defined in include/dt-bindings/regulator/dlg,da9211-regulator.h

          enable-gpios:
            maxItems: 1

required:
  - compatible
  - reg
  - reg-names
  - regulators

allOf:
  - if:
      properties:
        compatible:
          const: dlg,da9213-legacy
    then:
      properties:
        regulators:
          properties:
            BUCKB: false
  - if:
      properties:
        compatible:
          enum:
            - dlg,da9214-legacy
            - dlg,da9215-legacy
    then:
      properties:
        regulators:
          required:
            - BUCKA
            - BUCKB

additionalProperties: false

examples:
  - |
    i2c {
        #address-cells = <1>;
        #size-cells = <0>;

        regulator@68 {
            compatible = "dlg,da9214-legacy";
            reg = <0x68>, <0x69>;
            reg-names = "primary", "page2";
            status = "disabled";

            regulators {
                BUCKA {
                    regulator-name = "vproc-little";
                    regulator-min-microvolt = <800000>;
                    regulator-max-microvolt = <1200000>;
                    regulator-always-on;
                };

                BUCKB {
                    regulator-name = "vproc-big";
                    regulator-min-microvolt = <800000>;
                    regulator-max-microvolt = <1200000>;
                };
            };
        };
    };

...
```
