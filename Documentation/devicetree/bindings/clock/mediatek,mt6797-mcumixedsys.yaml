## Documentation/devicetree/bindings/power/supply/bq25890.yaml
```yaml
# SPDX-License-Identifier: GPL-2.0
# Copyright (C) 2021 Sebastian Reichel
%YAML 1.2
---
$id: http://devicetree.org/schemas/power/supply/bq25890.yaml#
$schema: http://devicetree.org/meta-schemas/core.yaml#

title: Bq25890, bq25892, bq25895 and bq25896 Li-Ion Charger

maintainers:
  - Sebastian Reichel <sre@kernel.org>

allOf:
  - $ref: power-supply.yaml#
  - not:
      required:
        - ti,read-only
        - ti,adopt-firmware-settings
  - if:
      required:
        - ti,status-poll-interval-ms
    then:
      required:
        - ti,read-only
  - if:
      required:
        - ti,read-only-adc
    then:
      required:
        - ti,read-only
  - if:
      anyOf:
        - required:
            - ti,read-only
        - required:
            - ti,adopt-firmware-settings
    then: {}
    else:
      required:
        - interrupts
        - ti,battery-regulation-voltage
        - ti,charge-current
        - ti,termination-current
        - ti,precharge-current
        - ti,minimum-sys-voltage
        - ti,boost-voltage
        - ti,boost-max-current

properties:
  compatible:
    oneOf:
      - enum:
          - ti,bq25890
      - items:
          - enum:
              - ti,bq25892
              - ti,bq25895
              - ti,bq25896
          - const: ti,bq25890

  reg:
    maxItems: 1

  interrupts:
    maxItems: 1

  ti,battery-regulation-voltage:
    $ref: /schemas/types.yaml#/definitions/uint32
    description: maximum charging voltage (in uV)

  ti,charge-current:
    $ref: /schemas/types.yaml#/definitions/uint32
    description: maximum charging current (in uA)

  ti,termination-current:
    $ref: /schemas/types.yaml#/definitions/uint32
    description: |
      charge will be terminated when current in constant-voltage phase
      drops below this value (in uA)

  ti,precharge-current:
    $ref: /schemas/types.yaml#/definitions/uint32
    description: maximum charge current during precharge phase (in uA)

  ti,minimum-sys-voltage:
    $ref: /schemas/types.yaml#/definitions/uint32
    description: |
      when battery is charging and it is below minimum system voltage,
      the system will be regulated above minimum-sys-voltage setting (in uV)

  ti,boost-voltage:
    $ref: /schemas/types.yaml#/definitions/uint32
    description: VBUS voltage level in boost mode (in uV)

  ti,boost-max-current:
    $ref: /schemas/types.yaml#/definitions/uint32
    description: maximum allowed current draw in boost mode (in uA)

  ti,boost-low-freq:
    description: boost mode frequency will be 500kHz, otherwise 1.5MHz
    type: boolean

  ti,use-ilim-pin:
    description: |
      ILIM resistor will be used and the input current will be the lower
      between the resistor setting and the IINLIM register setting
    type: boolean

  ti,thermal-regulation-threshold:
    $ref: /schemas/types.yaml#/definitions/uint32
    description: |
      temperature above which the charge current is lowered, to avoid overheating
      (in degrees Celsius). If omitted, the default setting will be used (120 degrees)

  ti,ibatcomp-micro-ohms:
    description: value of a resistor in series with the battery (in Micro Ohms)

  ti,ibatcomp-clamp-microvolt:
    description: max. charging voltage adjustment due to expected voltage drop on in-series resistor

  ti,read-only:
    description: |
      Do not write any charger register. This is intended for a bounded
      identification and status-observation stage when the board charge
      limits, interrupt wiring, or host-control ownership have not yet been
      established. The driver reads only the chip ID and non-destructive
      charge/online status fields (plus optional ADC results with
      ti,read-only-adc); it does not reset the charger, configure the watchdog
      or ADC, expose its OTG regulator, register an interrupt, or accept
      writable power-supply properties. BQ2589x fault status bits are
      read-to-clear and are intentionally not reported in this mode.
    type: boolean

  ti,status-poll-interval-ms:
    description: |
      Poll the non-destructive charge status fields at this interval and send
      a power-supply change notification when the status changes. This is for
      ti,read-only boards whose charger-status interrupt route is not known.
      It does not enable the charger watchdog, ADC, OTG regulator, or any
      writable power-supply property.
    minimum: 1000
    maximum: 3600000

  ti,read-only-adc:
    description: |
      In ti,read-only mode, also expose VOLTAGE_NOW and CURRENT_NOW from the
      BQ2589x ADC result registers. The driver never starts or configures ADC
      conversion in this mode. It reports a sample only while the chip's
      continuous-conversion bit is already set, otherwise these properties
      return -ENODATA. This is intended for a bounded diagnostic stage where
      charger policy and ADC ownership remain outside Linux.
    type: boolean

  ti,adopt-firmware-settings:
    description: |
      Preserve the charger configuration left by firmware and keep charge
      policy read-only. The driver reads the existing current, voltage and
      ancillary settings without resetting the chip, changing CHG_CFG,
      configuring the ADC, registering an interrupt or OTG regulator, or
      accepting writable power-supply properties. If the firmware left the
      charger watchdog enabled, the driver immediately resets its timer and
      continues to service it at one quarter of its configured timeout. The
      watchdog reset bit is the only charger register field written in this
      mode. System suspend is rejected while that watchdog is enabled because
      servicing it during sleep has not been delegated to another agent.
    type: boolean

required:
  - compatible
  - reg

unevaluatedProperties: false

examples:
  - |
    #include <dt-bindings/interrupt-controller/irq.h>
    i2c {
      #address-cells = <1>;
      #size-cells = <0>;

      charger@6a {
        compatible = "ti,bq25890";
        reg = <0x6a>;

        interrupt-parent = <&gpio1>;
        interrupts = <16 IRQ_TYPE_EDGE_FALLING>;

        ti,battery-regulation-voltage = <4200000>;
        ti,charge-current = <1000000>;
        ti,termination-current = <50000>;
        ti,precharge-current = <128000>;
        ti,minimum-sys-voltage = <3600000>;
        ti,boost-voltage = <5000000>;
        ti,boost-max-current = <1000000>;

        ti,use-ilim-pin;
        ti,thermal-regulation-threshold = <120>;
      };
    };
```

## Documentation/devicetree/bindings/power/supply/mediatek,mt6351-fg-readonly.yaml
```yaml
# SPDX-License-Identifier: GPL-2.0-only OR BSD-2-Clause
%YAML 1.2
---
$id: http://devicetree.org/schemas/power/supply/mediatek,mt6351-fg-readonly.yaml#
$schema: http://devicetree.org/meta-schemas/core.yaml#

title: MediaTek MT6351 read-only fuel-gauge qualification

maintainers:
  - linux-mediatek@lists.infradead.org

description: |
  The MT6351 FGADC needs a write/latch/clear sequence for coherent gauge data.
  This node is an opt-in diagnostic stage that exposes only raw, direct-read
  values. It does not initialize or calibrate the fuel gauge, latch a sample,
  service its interrupts, or provide a battery capacity estimate.

properties:
  compatible:
    const: mediatek,mt6351-fg-readonly

required:
  - compatible

additionalProperties: false

examples:
  - |
    pmic {
      fuel-gauge {
        compatible = "mediatek,mt6351-fg-readonly";
      };
    };
```

## Documentation/devicetree/bindings/power/supply/mediatek,mt6351-fgadc.yaml
```yaml
# SPDX-License-Identifier: GPL-2.0-only OR BSD-2-Clause
%YAML 1.2
---
$id: http://devicetree.org/schemas/power/supply/mediatek,mt6351-fgadc.yaml#
$schema: http://devicetree.org/meta-schemas/core.yaml#

title: MediaTek MT6351 FGADC battery monitor

maintainers:
  - linux-mediatek@lists.infradead.org

description: |
  The MT6351 fuel-gauge ADC reports calibrated current and a coulomb counter.
  Its hardware configuration and calibration are board-specific.  The driver
  does not start the hardware unless this node is enabled and explicitly grants
  ownership with mediatek,initialize-fgadc.  The properties below are required
  so that Linux never substitutes a battery or factory calibration value.

allOf:
  - $ref: power-supply.yaml#
  - if:
      required: [mediatek,capacity-model]
    then:
      required:
        - monitored-battery
        - power-supplies
        - mediatek,resistance-table-0

properties:
  compatible:
    const: mediatek,mt6351-fgadc

  monitored-battery:
    $ref: /schemas/types.yaml#/definitions/phandle
    description: Optional battery characteristics for the monitored pack.

  mediatek,capacity-model:
    $ref: /schemas/types.yaml#/definitions/int32-matrix
    minItems: 1
    maxItems: 4
    items:
      items:
        - minimum: -50
          maximum: 100
        - minimum: 100000
          maximum: 100000000
    description: |
      Optional software fuel-gauge model. Each pair gives temperature in
      degrees Celsius and model full charge (Qmax) in microamp-hours. Pairs
      must be in increasing temperature order. These are model estimates,
      not measured aged capacity or the pack's design capacity. Each pair
      requires a resistance table at the same index and a corresponding
      OCV table in monitored-battery at exactly that temperature. With all
      inputs present the driver estimates state of charge using compensated
      voltage and coulomb-counter changes, without changing charger policy.

  power-supplies:
    maxItems: 1
    description: |
      Optional charger for the monitored battery. It must report battery-side
      voltage, battery thermistor temperature and charging status through its
      power-supply interface. These measurements supplement the FGADC current and coulomb
      counter; no charger policy is changed by the battery monitor.

  mediatek,initialize-fgadc:
    description: |
      Permit Linux to enable the two FGADC clocks, program the initial FGADC
      control byte, and select the oversampling ratio.  The driver snapshots
      and restores those fields on probe failure and removal.  It does not
      reset the hardware coulomb counter.
    type: boolean

  vdda-supply:
    description:
      MT6351 VA18 LDO, which powers the FGADC analog front end. Without it
      the converter never latches a sample.

  mediatek,fgadc-init-control:
    description: |
      Lower FGADC_CON0 byte to program before setting FG_ON. Bit 0 must be
      clear; the driver sets it only after the initial value is installed.
    $ref: /schemas/types.yaml#/definitions/uint32
    maximum: 254

  mediatek,fgadc-osr:
    description: FGADC oversampling ratio field programmed in FGADC_CON15.
    $ref: /schemas/types.yaml#/definitions/uint32
    minimum: 1
    maximum: 15

  mediatek,fg-resistance-milliohm:
    description: Board current-sense resistance in milliohms.
    $ref: /schemas/types.yaml#/definitions/uint32
    minimum: 1

  mediatek,fg-board-base:
    description: Board current-calibration base factor.
    $ref: /schemas/types.yaml#/definitions/uint32
    minimum: 1

  mediatek,fg-board-slope:
    description: Board current-calibration slope factor.
    $ref: /schemas/types.yaml#/definitions/uint32
    minimum: 1

  mediatek,car-tune:
    description: Factory coulomb/current calibration, with 100 meaning unity.
    $ref: /schemas/types.yaml#/definitions/uint32
    minimum: 1

  mediatek,fg-trim-permille:
    description: PMIC current/coulomb trim factor, with 1000 meaning unity.
    $ref: /schemas/types.yaml#/definitions/uint32
    minimum: 1

patternProperties:
  '^mediatek,resistance-table-[0-3]$':
    $ref: /schemas/types.yaml#/definitions/uint32-matrix
    minItems: 2
    maxItems: 100
    items:
      items:
        - minimum: 2000000
          maximum: 5000000
        - minimum: 1
          maximum: 20000000
    description: |
      Pairs of zero-current battery voltage in microvolts and internal
      resistance in microohms, ordered by strictly decreasing voltage.
      The index selects the temperature in mediatek,capacity-model. The
      resistance model must describe the battery measured by power-supplies.

required:
  - compatible
  - mediatek,initialize-fgadc
  - vdda-supply
  - mediatek,fgadc-init-control
  - mediatek,fgadc-osr
  - mediatek,fg-resistance-milliohm
  - mediatek,fg-board-base
  - mediatek,fg-board-slope
  - mediatek,car-tune
  - mediatek,fg-trim-permille

additionalProperties: false
```
