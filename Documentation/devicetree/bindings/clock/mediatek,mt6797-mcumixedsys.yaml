## Documentation/devicetree/bindings/interconnect/mediatek,mt6797-cci.yaml
```yaml
# SPDX-License-Identifier: (GPL-2.0-only OR BSD-2-Clause)
%YAML 1.2
---
$id: http://devicetree.org/schemas/interconnect/mediatek,mt6797-cci.yaml#
$schema: http://devicetree.org/meta-schemas/core.yaml#

title: MediaTek MT6797 CCI frequency and shared voltage policy

maintainers:
  - George Whewell <georgerw@gmail.com>

description: |
  The MT6797 CCI shares DA9214 BUCKA with the two Cortex-A53 clusters.
  CPU SRAM voltage tracking is provided by their regulator coupler.
  The native CCI clock provider owns PLL and divider transitions, so this
  consumer must not reparent or directly program the raw CCI PLL. The
  Cortex-A72 cluster contributes its frequency to the CCI policy but has
  a separate voltage supply and may have no CPUFreq policy.

properties:
  compatible:
    const: mediatek,mt6797-cci

  clocks:
    items:
      - description: Native compound CCI clock
      - description: Cortex-A53 LL cluster clock
      - description: Cortex-A53 L cluster clock
      - description: Cortex-A72 cluster clock

  clock-names:
    items:
      - const: cci
      - const: ll
      - const: l
      - const: a72

  proc-supply:
    description: Shared A53 and CCI voltage regulator, coupled to CPU SRAM.

  operating-points-v2: true

  access-controllers:
    maxItems: 1

required:
  - compatible
  - clocks
  - clock-names
  - proc-supply
  - operating-points-v2
  - access-controllers

additionalProperties: false

examples:
  - |
    #include <dt-bindings/clock/mt6797-clk.h>
    cci {
        compatible = "mediatek,mt6797-cci";
        clocks = <&cpuclk CLK_MCU_CCI>, <&cpuclk CLK_MCU_MP0>,
                 <&cpuclk CLK_MCU_MP1>, <&cpuclk CLK_MCU_MP2>;
        clock-names = "cci", "ll", "l", "a72";
        proc-supply = <&da9214_bucka>;
        operating-points-v2 = <&cci_opp>;
        access-controllers = <&dvfsp_handoff>;
    };
```

## Documentation/devicetree/bindings/leds/awinic,aw9120.yaml
```yaml
# SPDX-License-Identifier: (GPL-2.0-only OR BSD-2-Clause)
%YAML 1.2
---
$id: http://devicetree.org/schemas/leds/awinic,aw9120.yaml#
$schema: http://devicetree.org/meta-schemas/core.yaml#

title: AWINIC AW9120 20-channel LED driver

maintainers:
  - George Whewell <georgerw@gmail.com>

description: |
  The AW9120 is an I2C LED driver with 20 constant-current sinks (LED1 to
  LED20). Each output has an 8-level maximum current setting from 0 to
  24.5 mA in 3.5 mA steps and 256-level PWM dimming. Outputs can be used
  individually or grouped into multicolor LEDs.

  Data sheet: AWINIC AW9120, 20 Programmable LED Driver, V1.4 (Feb. 2019).

properties:
  compatible:
    const: awinic,aw9120

  reg:
    enum: [0x2c, 0x2d]

  "#address-cells":
    const: 1

  "#size-cells":
    const: 0

  enable-gpios:
    maxItems: 1
    description:
      GPIO connected to the active-low PDN (power-down) input. The pin
      holds the chip in shutdown while low. If absent, PDN must be tied
      high.

  vbat-supply:
    description: Regulator for the VBAT power input.

  vio-supply:
    description:
      Regulator for the I2C interface high level. It does not supply a pin
      of the AW9120, but the SCL, SDA and INTN pull-ups.

  interrupts:
    maxItems: 1
    description: Open-drain, active-low INTN output.

patternProperties:
  "^multi-led-[0-9]+$":
    type: object
    $ref: leds-class-multicolor.yaml#
    unevaluatedProperties: false

    properties:
      "#address-cells":
        const: 1

      "#size-cells":
        const: 0

    patternProperties:
      "^led@[0-9a-f]+$":
        type: object
        $ref: "#/$defs/channel"
        unevaluatedProperties: false

        required:
          - color

    required:
      - "#address-cells"
      - "#size-cells"

  "^led@[0-9a-f]+$":
    type: object
    $ref: "#/$defs/channel"
    unevaluatedProperties: false

$defs:
  channel:
    $ref: common.yaml#

    properties:
      reg:
        description:
          Output index. 0 to 19 select the LED1 to LED20 pins.
        minimum: 0
        maximum: 19

      led-max-microamp:
        description:
          Maximum current of the output. The current is programmed in
          3.5 mA steps.
        minimum: 3500
        maximum: 24500
        multipleOf: 3500
        default: 3500

    required:
      - reg

required:
  - compatible
  - reg
  - "#address-cells"
  - "#size-cells"

additionalProperties: false

examples:
  - |
    #include <dt-bindings/gpio/gpio.h>
    #include <dt-bindings/leds/common.h>

    i2c {
        #address-cells = <1>;
        #size-cells = <0>;

        led-controller@2c {
            compatible = "awinic,aw9120";
            reg = <0x2c>;
            #address-cells = <1>;
            #size-cells = <0>;
            enable-gpios = <&pio 245 GPIO_ACTIVE_HIGH>;

            multi-led-1 {
                color = <LED_COLOR_ID_RGB>;
                function = LED_FUNCTION_INDICATOR;
                function-enumerator = <1>;
                #address-cells = <1>;
                #size-cells = <0>;

                led@0 {
                    reg = <0>;
                    color = <LED_COLOR_ID_RED>;
                    led-max-microamp = <3500>;
                };

                led@1 {
                    reg = <1>;
                    color = <LED_COLOR_ID_GREEN>;
                    led-max-microamp = <3500>;
                };

                led@2 {
                    reg = <2>;
                    color = <LED_COLOR_ID_BLUE>;
                    led-max-microamp = <3500>;
                };
            };

            led@12 {
                reg = <18>;
                color = <LED_COLOR_ID_RED>;
                function = LED_FUNCTION_CAPSLOCK;
                led-max-microamp = <7000>;
            };
        };
    };
...
```

## Documentation/devicetree/bindings/media/i2c/hynix,hi556.yaml
```yaml
# SPDX-License-Identifier: (GPL-2.0-only OR BSD-2-Clause)
%YAML 1.2
---
$id: http://devicetree.org/schemas/media/i2c/hynix,hi556.yaml#
$schema: http://devicetree.org/meta-schemas/core.yaml#

title: SK Hynix Hi-556 5M Pixel MIPI CSI-2 sensor

maintainers:
  - George Whewell <georgerw@gmail.com>

description:
  The Hi-556 is a raw Bayer image sensor with a two-lane MIPI CSI-2
  data interface and a CCI (I2C compatible) control bus.

allOf:
  - $ref: /schemas/media/video-interface-devices.yaml#

properties:
  compatible:
    const: hynix,hi556

  reg:
    maxItems: 1

  clocks:
    items:
      - description: External clock (MCLK).

  reset-gpios:
    description: GPIO connected to the RESETB pin. Active low.
    maxItems: 1

  powerdown-gpios:
    description: GPIO that holds the sensor in power down when asserted.
    maxItems: 1

  dovdd-supply:
    description: Digital I/O supply.

  avdd-supply:
    description: Analog supply.

  dvdd-supply:
    description: Digital core supply.

  port:
    $ref: /schemas/graph.yaml#/$defs/port-base
    unevaluatedProperties: false

    properties:
      endpoint:
        $ref: /schemas/media/video-interfaces.yaml#
        unevaluatedProperties: false

        properties:
          data-lanes:
            items:
              - const: 1
              - const: 2

          link-frequencies: true

        required:
          - data-lanes

required:
  - compatible
  - reg
  - clocks
  - dovdd-supply
  - avdd-supply
  - dvdd-supply
  - port

unevaluatedProperties: false

examples:
  - |
    #include <dt-bindings/gpio/gpio.h>

    i2c {
        #address-cells = <1>;
        #size-cells = <0>;

        camera@20 {
            compatible = "hynix,hi556";
            reg = <0x20>;
            clocks = <&mclk 1>;
            assigned-clocks = <&mclk 1>;
            assigned-clock-rates = <24000000>;
            dovdd-supply = <&vcamio>;
            avdd-supply = <&vcama>;
            dvdd-supply = <&vcamd>;
            reset-gpios = <&pio 33 GPIO_ACTIVE_LOW>;
            powerdown-gpios = <&pio 29 GPIO_ACTIVE_LOW>;

            port {
                endpoint {
                    data-lanes = <1 2>;
                };
            };
        };
    };
...
```

## Documentation/devicetree/bindings/media/i2c/siliconfile,sp5509.yaml
```yaml
# SPDX-License-Identifier: (GPL-2.0-only OR BSD-2-Clause)
%YAML 1.2
---
$id: http://devicetree.org/schemas/media/i2c/siliconfile,sp5509.yaml#
$schema: http://devicetree.org/meta-schemas/core.yaml#

title: SiliconFile SP5509 CMOS image sensor

maintainers:
  - Sakari Ailus <sakari.ailus@linux.intel.com>

description: |
  The SiliconFile SP5509 is a five megapixel CMOS image sensor derived from
  the Hynix HI556 design. It provides 2592x1944 10-bit Bayer frames over a
  two-lane MIPI CSI-2 interface and is controlled over I2C.

allOf:
  - $ref: /schemas/media/video-interface-devices.yaml#

properties:
  compatible:
    const: siliconfile,sp5509

  reg:
    maxItems: 1

  clocks:
    maxItems: 1

  clock-names:
    const: clk

  dovdd-supply:
    description: Digital I/O supply, nominally 1.8 V.

  avdd-supply:
    description: Analog supply, nominally 2.8 V.

  dvdd-supply:
    description: Digital core supply, nominally 1.2 V.

  reset-gpios:
    description: Sensor reset GPIO.
    maxItems: 1

  powerdown-gpios:
    description: Sensor power-down GPIO.
    maxItems: 1

  port:
    $ref: /schemas/graph.yaml#/$defs/port-base
    additionalProperties: false

    properties:
      endpoint:
        $ref: /schemas/media/video-interfaces.yaml#
        unevaluatedProperties: false

        properties:
          data-lanes:
            items:
              - const: 1
              - const: 2

          link-frequencies:
            items:
              - const: 440000000

        required:
          - data-lanes
          - link-frequencies

required:
  - compatible
  - reg
  - clocks
  - clock-names
  - dovdd-supply
  - avdd-supply
  - dvdd-supply
  - reset-gpios
  - powerdown-gpios
  - port

unevaluatedProperties: false

examples:
  - |
    #include <dt-bindings/gpio/gpio.h>

    i2c {
        #address-cells = <1>;
        #size-cells = <0>;

        camera@20 {
            compatible = "siliconfile,sp5509";
            reg = <0x20>;

            clocks = <&camera_clk>;
            clock-names = "clk";

            dovdd-supply = <&camera_dovdd>;
            avdd-supply = <&camera_avdd>;
            dvdd-supply = <&camera_dvdd>;

            reset-gpios = <&gpio0 1 GPIO_ACTIVE_LOW>;
            powerdown-gpios = <&gpio0 2 GPIO_ACTIVE_LOW>;

            port {
                sp5509_out: endpoint {
                    remote-endpoint = <&seninf_in>;
                    data-lanes = <1 2>;
                    link-frequencies = /bits/ 64 <440000000>;
                };
            };
        };
    };
...
```

## Documentation/devicetree/bindings/media/mediatek,mt6797-camsv.yaml
```yaml
# SPDX-License-Identifier: (GPL-2.0-only OR BSD-2-Clause)
%YAML 1.2
---
$id: http://devicetree.org/schemas/media/mediatek,mt6797-camsv.yaml#
$schema: http://devicetree.org/meta-schemas/core.yaml#

title: MediaTek MT6797 CAMSV capture engine

maintainers:
  - George Whewell <georgerw@gmail.com>

description: |
  CAMSV is a small raw camera capture engine containing a timing generator,
  pixel packer, frame-buffer controller and one image DMA output. MT6797 has
  six register windows, but only CAMSV0 has an independently clocked and IOMMU
  mapped path established here. The driver uses the DMA API and the CAM_SV0
  M4U port; Android ION and the vendor camera ioctl ABI are not part of this
  binding.

properties:
  compatible:
    const: mediatek,mt6797-camsv

  reg:
    maxItems: 1

  interrupts:
    maxItems: 1

  clocks:
    items:
      - description: Camera larb clock
      - description: Camera subsystem clock
      - description: Camera timing-generator clock
      - description: CAMSV0 engine clock

  clock-names:
    items:
      - const: larb
      - const: camsys
      - const: camtg
      - const: camsv

  power-domains:
    maxItems: 1

  iommus:
    maxItems: 1

  port:
    $ref: /schemas/graph.yaml#/$defs/port-base
    unevaluatedProperties: false
    description: Pixel input from SENINF

    properties:
      endpoint:
        $ref: video-interfaces.yaml#
        unevaluatedProperties: false

required:
  - compatible
  - reg
  - interrupts
  - clocks
  - clock-names
  - power-domains
  - iommus
  - port

additionalProperties: false

examples:
  - |
    #include <dt-bindings/clock/mt6797-clk.h>
    #include <dt-bindings/interrupt-controller/arm-gic.h>
    #include <dt-bindings/interrupt-controller/irq.h>
    #include <dt-bindings/memory/mt6797-larb-port.h>
    #include <dt-bindings/power/mt6797-power.h>

    camsv@1a050000 {
        compatible = "mediatek,mt6797-camsv";
        reg = <0x1a050000 0x1000>;
        interrupts = <GIC_SPI 252 IRQ_TYPE_LEVEL_LOW>;
        clocks = <&camsys CLK_CAM_LARB2>,
                 <&camsys CLK_CAM_CAMSYS>,
                 <&camsys CLK_CAM_CAMTG>,
                 <&camsys CLK_CAM_CAMSV0>;
        clock-names = "larb", "camsys", "camtg", "camsv";
        power-domains = <&scpsys MT6797_POWER_DOMAIN_ISP>;
        iommus = <&m4u M4U_PORT_CAM_SV0>;

        port {
            camsv0_in: endpoint {
                remote-endpoint = <&seninf_out>;
            };
        };
    };
```
