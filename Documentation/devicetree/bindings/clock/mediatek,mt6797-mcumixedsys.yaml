## Documentation/devicetree/bindings/media/mediatek,mt6797-seninf.yaml
```yaml
# SPDX-License-Identifier: (GPL-2.0-only OR BSD-2-Clause)
%YAML 1.2
---
$id: http://devicetree.org/schemas/media/mediatek,mt6797-seninf.yaml#
$schema: http://devicetree.org/meta-schemas/core.yaml#

title: MediaTek MT6797 sensor interface and CSI-2 receiver

maintainers:
  - George Whewell <georgerw@gmail.com>

description: |
  SENINF is the CSI-2 receiver and sensor-interface crossbar in the MT6797
  camera subsystem. The block contains a shared top-level window, eight 4 KiB
  sensor-interface windows, and two MIPI receiver analog windows. It has no
  independently described interrupt in the MT6797 platform source.

  The binding describes the complete resource owner. The currently supported
  route is the MT6797 Gemini camera1/sub NCSI2 port with two data lanes. Other
  routes remain disabled until their D-PHY programming is established.

properties:
  compatible:
    const: mediatek,mt6797-seninf

  reg:
    items:
      - description: Shared SENINF top level and eight 4 KiB receiver windows
      - description: MIPI receiver CSI0 analog window
      - description: MIPI receiver CSI1 analog window

  reg-names:
    items:
      - const: seninf
      - const: csi0-ana
      - const: csi1-ana

  clocks:
    items:
      - description: SENINF receiver clock
      - description: Camera timing-generator gate used by MCLK2
      - description: 48 MHz parent for the 24 MHz MCLK2 output

  clock-names:
    items:
      - const: seninf
      - const: camtg
      - const: mclk-parent

  '#clock-cells':
    const: 0
    description: The fixed 24 MHz camera1/sub MCLK2 sensor master clock

  power-domains:
    maxItems: 1

  nvmem-cells:
    maxItems: 1
    description:
      Five consecutive MT6797 devinfo words 0x25 through 0x29. They contain
      the per-device MIPI CSI analog calibration consumed by the receiver.

  nvmem-cell-names:
    const: csi-calibration-data

  ports:
    $ref: /schemas/graph.yaml#/properties/ports

    properties:
      port@0:
        $ref: /schemas/graph.yaml#/$defs/port-base
        unevaluatedProperties: false
        description: CSI-2 input from a camera sensor

        properties:
          endpoint:
            $ref: video-interfaces.yaml#
            unevaluatedProperties: false

            properties:
              bus-type:
                const: 4

              data-lanes:
                minItems: 1
                maxItems: 4

            required:
              - data-lanes

      port@1:
        $ref: /schemas/graph.yaml#/properties/port
        description: Pixel output to the camera capture engine

    required:
      - port@0
      - port@1

required:
  - compatible
  - reg
  - reg-names
  - clocks
  - clock-names
  - '#clock-cells'
  - power-domains

additionalProperties: false

examples:
  - |
    #include <dt-bindings/clock/mt6797-clk.h>
    #include <dt-bindings/power/mt6797-power.h>

    csi@1a040000 {
        compatible = "mediatek,mt6797-seninf";
        reg = <0x1a040000 0x8000>,
              <0x10217000 0x1000>,
              <0x10218000 0x1000>;
        reg-names = "seninf", "csi0-ana", "csi1-ana";
        clocks = <&camsys CLK_CAM_SENINF>,
                 <&camsys CLK_CAM_CAMTG>,
                 <&topckgen CLK_TOP_MUX_CAMTG>;
        clock-names = "seninf", "camtg", "mclk-parent";
        assigned-clocks = <&topckgen CLK_TOP_MUX_CAMTG>;
        assigned-clock-parents = <&topckgen CLK_TOP_UNIVPLL_D26>;
        #clock-cells = <0>;
        power-domains = <&scpsys MT6797_POWER_DOMAIN_ISP>;
        status = "disabled";
    };
```

## Documentation/devicetree/bindings/net/bluetooth/mediatek,mt6797-bluetooth.yaml
```yaml
# SPDX-License-Identifier: (GPL-2.0-only OR BSD-2-Clause)
%YAML 1.2
---
$id: http://devicetree.org/schemas/net/bluetooth/mediatek,mt6797-bluetooth.yaml#
$schema: http://devicetree.org/meta-schemas/core.yaml#

title: MediaTek MT6797 CONSYS Bluetooth function

maintainers:
  - Linux Mediatek Maintainers <linux-mediatek@lists.infradead.org>

description: |
  The Bluetooth function is an HCI consumer of its parent MT6797 CONSYS
  aggregate. The parent exclusively owns firmware, power, VCN33, BTIF and the
  multiplexed full-STP session, so this child has no duplicate resources.

allOf:
  - $ref: bluetooth-controller.yaml#

properties:
  compatible:
    const: mediatek,mt6797-bluetooth

required:
  - compatible

unevaluatedProperties: false

examples:
  - |
    bluetooth {
        compatible = "mediatek,mt6797-bluetooth";
    };
```

## Documentation/devicetree/bindings/net/mediatek,mt6797-ccci.yaml
```yaml
# SPDX-License-Identifier: (GPL-2.0-only OR BSD-2-Clause)
%YAML 1.2
---
$id: http://devicetree.org/schemas/net/mediatek,mt6797-ccci.yaml#
$schema: http://devicetree.org/meta-schemas/core.yaml#

title: MediaTek MT6797 CCCI integrated modem interface

maintainers:
  - George Whewell <georgerw@gmail.com>

description: |
  The MT6797 Cross-Core Communication Interface (CCCI) combines the AP and
  modem views of CLDMA, CCIF mailboxes, a modem watchdog interrupt, and a
  reserved shared-memory window. The interface transports framed control and
  data channels between Linux and firmware already loaded and started by a
  separate modem lifecycle owner.

  The node does not describe firmware loading, modem power, reset or boot-vector
  release. The lifecycle owner retains the AP CLDMA register reservations
  through handoff. The transport needs exclusive ownership of the reset
  engine before programming queue heads; idle status alone is insufficient.

properties:
  compatible:
    const: mediatek,mt6797-ccci

  reg:
    items:
      - description: AP view of the always-on CLDMA registers
      - description: Modem view of the always-on CLDMA registers
      - description: AP view of the power-domain CLDMA registers
      - description: Modem view of the power-domain CLDMA registers
      - description: AP CCIF mailbox registers
      - description: Modem CCIF mailbox registers

  reg-names:
    items:
      - const: ap-cldma-ao
      - const: md-cldma-ao
      - const: ap-cldma-pdn
      - const: md-cldma-pdn
      - const: ap-ccif
      - const: md-ccif

  interrupts:
    items:
      - description: CLDMA completion and error interrupt
      - description: AP CCIF mailbox interrupt
      - description: Modem watchdog interrupt

  interrupt-names:
    items:
      - const: cldma
      - const: ap-ccif
      - const: md-wdt

  memory-region:
    maxItems: 1
    description: Reserved AP-to-modem CCCI shared-memory window.

  memory-region-names:
    items:
      - const: md-shared

required:
  - compatible
  - reg
  - reg-names
  - interrupts
  - interrupt-names
  - memory-region
  - memory-region-names

additionalProperties: false

examples:
  - |
    #include <dt-bindings/interrupt-controller/arm-gic.h>
    #include <dt-bindings/interrupt-controller/irq.h>

    reserved-memory {
        #address-cells = <1>;
        #size-cells = <1>;
        ranges;

        ccci_shared: memory@88000000 {
            reg = <0x88000000 0x600000>;
            no-map;
        };
    };

    modem@10014000 {
        compatible = "mediatek,mt6797-ccci";
        reg = <0x10014000 0x1e00>, <0x10015000 0x1e00>,
              <0x10219000 0x1e00>, <0x1021a000 0x1e00>,
              <0x10209000 0x1000>, <0x1020a000 0x1000>;
        reg-names = "ap-cldma-ao", "md-cldma-ao",
                    "ap-cldma-pdn", "md-cldma-pdn",
                    "ap-ccif", "md-ccif";
        interrupts = <GIC_SPI 265 IRQ_TYPE_LEVEL_HIGH>,
                     <GIC_SPI 147 IRQ_TYPE_LEVEL_LOW>,
                     <GIC_SPI 266 IRQ_TYPE_EDGE_FALLING>;
        interrupt-names = "cldma", "ap-ccif", "md-wdt";
        memory-region = <&ccci_shared>;
        memory-region-names = "md-shared";
    };
```

## Documentation/devicetree/bindings/net/wireless/mediatek,mt6797-wifi.yaml
```yaml
# SPDX-License-Identifier: (GPL-2.0-only OR BSD-2-Clause)
%YAML 1.2
---
$id: http://devicetree.org/schemas/net/wireless/mediatek,mt6797-wifi.yaml#
$schema: http://devicetree.org/meta-schemas/core.yaml#

title: MediaTek MT6797 Wi-Fi host interface

maintainers:
  - Julien Etienne <julien.etienne@gmail.com>

description:
  The MT6797 contains an AHB-attached SDIO-like host interface for the Wi-Fi
  function in the connectivity subsystem.  This node describes only the host
  interface aperture, its interrupt, and the Wi-Fi-specific VCN33 rail.  The
  shared connectivity processor, firmware, clocks, resets, and common rails
  belong to a separate subsystem owner.

properties:
  compatible:
    const: mediatek,mt6797-wifi

  reg:
    maxItems: 1

  interrupts:
    maxItems: 1

  interrupt-names:
    const: hif

  vcn33-supply:
    description: Wi-Fi enable input of the shared VCN33 regulator output.

required:
  - compatible
  - reg
  - interrupts
  - interrupt-names
  - vcn33-supply

additionalProperties: false

examples:
  - |
    #include <dt-bindings/interrupt-controller/arm-gic.h>
    #include <dt-bindings/interrupt-controller/irq.h>

    wifi@180f0000 {
        compatible = "mediatek,mt6797-wifi";
        reg = <0x180f0000 0x1100>;
        interrupts = <GIC_SPI 283 IRQ_TYPE_LEVEL_LOW>;
        interrupt-names = "hif";
        vcn33-supply = <&wifi_vcn33>;
        status = "disabled";
    };
...
```

## Documentation/devicetree/bindings/nvmem/mediatek,mt6797-atag.yaml
```yaml
# SPDX-License-Identifier: (GPL-2.0-only OR BSD-2-Clause)
%YAML 1.2
---
$id: http://devicetree.org/schemas/nvmem/mediatek,mt6797-atag.yaml#
$schema: http://devicetree.org/meta-schemas/core.yaml#

title: MediaTek MT6797 LK devinfo thermal calibration

description: |
  The retained MT6797 Little Kernel bootloader appends a fixed-format,
  read-only devinfo payload to /chosen/atag,devinfo.  This provider validates
  that handoff property and exposes the ordered thermal calibration cell.
  It does not access the efuse MMIO block.

maintainers:
  - Julien Etienne <julien.etienne@gmail.com>

allOf:
  - $ref: nvmem.yaml#
  - $ref: nvmem-provider.yaml#

properties:
  $nodename:
    const: atag-devinfo

  compatible:
    const: mediatek,mt6797-atag-devinfo

  "#address-cells":
    const: 1

  "#size-cells":
    const: 1

  read-only:
    type: boolean

patternProperties:
  "^calibration-data@0$":
    type: object
    properties:
      reg:
        minItems: 1
        maxItems: 1
        items:
          - items:
              - const: 0
              - const: 12
    required:
      - reg
    additionalProperties: false

required:
  - compatible
  - "#address-cells"
  - "#size-cells"
  - read-only

unevaluatedProperties: false

examples:
  - |
    firmware {
      atag_devinfo: atag-devinfo {
        compatible = "mediatek,mt6797-atag-devinfo";
        #address-cells = <1>;
        #size-cells = <1>;
        read-only;

        thermal_calibration: calibration-data@0 {
          reg = <0 12>;
        };
      };
    };
```

## Documentation/devicetree/bindings/power/mediatek,mt6797-scpsys.yaml
```yaml
# SPDX-License-Identifier: (GPL-2.0-only OR BSD-2-Clause)
%YAML 1.2
---
$id: http://devicetree.org/schemas/power/mediatek,mt6797-scpsys.yaml#
$schema: http://devicetree.org/meta-schemas/core.yaml#

title: MediaTek MT6797 SCPSYS power controller

maintainers:
  - Matthias Brugger <mbrugger@suse.com>
  - AngeloGioacchino Del Regno <angelogioacchino.delregno@collabora.com>

description: |
  The MT6797 System Control Processor System (SCPSYS) provides the generic
  power domains used by multimedia, video decode, audio, and GPU consumers.
  This binding describes the legacy single-node provider consumed by the
  mtk-scpsys driver.

properties:
  $nodename:
    pattern: '^power-controller(@[0-9a-f]+)?$'

  compatible:
    const: mediatek,mt6797-scpsys

  reg:
    maxItems: 1

  infracfg:
    $ref: /schemas/types.yaml#/definitions/phandle
    description: Phandle to the MT6797 infracfg syscon.

  '#power-domain-cells':
    const: 1

  clocks:
    minItems: 4
    maxItems: 4

  clock-names:
    items:
      - const: mfg
      - const: mfg_52m
      - const: mm
      - const: vdec

required:
  - compatible
  - reg
  - infracfg
  - '#power-domain-cells'
  - clocks
  - clock-names

additionalProperties: false

examples:
  - |
    #include <dt-bindings/clock/mt6797-clk.h>
    #include <dt-bindings/power/mt6797-power.h>

    soc {
        #address-cells = <2>;
        #size-cells = <2>;

        scpsys: power-controller@10006000 {
            compatible = "mediatek,mt6797-scpsys";
            #power-domain-cells = <1>;
            reg = <0 0x10006000 0 0x1000>;
            infracfg = <&infracfg>;
            clocks = <&topckgen CLK_TOP_MUX_MFG>,
                     <&topckgen CLK_TOP_MUX_MFG_52M>,
                     <&topckgen CLK_TOP_MUX_MM>,
                     <&topckgen CLK_TOP_MUX_VDEC>;
            clock-names = "mfg", "mfg_52m", "mm", "vdec";
        };
    };
```
