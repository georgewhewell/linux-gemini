## Documentation/devicetree/bindings/soc/mediatek/mediatek,mt6797-dvfsp-handoff.yaml
```yaml
# SPDX-License-Identifier: (GPL-2.0-only OR BSD-2-Clause)
%YAML 1.2
---
$id: http://devicetree.org/schemas/soc/mediatek/mediatek,mt6797-dvfsp-handoff.yaml#
$schema: http://devicetree.org/meta-schemas/core.yaml#

title: MediaTek MT6797 stopped DVFSP firmware handoff

maintainers:
  - Gemini Mainline Experiment <gemini-mainline@example.invalid>

description: |
  This device receives a one-way handoff from a stopped MT6797 CPU-DVFS
  firmware instance. It validates a stable CSPM reset state, temporarily
  acquires the shared I2C_APPM clock through the common clock framework,
  balances that reference, and independently verifies that the physical
  gate became closed without changing the firmware state. It also observes
  the shared AP-DMA gate. Consumer validation proves both bulk clocks are
  ungated while held, requires I2C_APPM to remain gated throughout a bounded
  cleanup window, and requires AP-DMA to be observed gated at least once;
  unrelated users may reopen the shared AP-DMA gate.

  The device does not start, stop, pause, reset, or load DVFSP firmware. It
  does not directly write CSPM or infracfg registers. It is not a complete
  DVFSP coordination provider and does not by itself authorize an I2C6
  controller, regulator, or CPU-voltage consumer.

properties:
  compatible:
    const: mediatek,mt6797-dvfsp-handoff

  reg:
    maxItems: 1
    description: CSPM register window used for read-only validation.

  clocks:
    maxItems: 1
    description: Shared I2C_APPM clock normalized through the clock framework.

  clock-names:
    const: i2c

  mediatek,infracfg:
    $ref: /schemas/types.yaml#/definitions/phandle
    description:
      Phandle to infracfg for independent I2C_APPM and AP-DMA gate-status
      readback.

  "#access-controller-cells":
    const: 0
    description:
      Declares this receiver as the access controller for the single I2C
      controller whose use depends on a completed handoff.

required:
  - compatible
  - reg
  - clocks
  - clock-names
  - mediatek,infracfg
  - "#access-controller-cells"

additionalProperties: false

examples:
  - |
    #include <dt-bindings/clock/mt6797-clk.h>

    soc {
        #address-cells = <2>;
        #size-cells = <2>;

        dvfsp-handoff@11015000 {
            compatible = "mediatek,mt6797-dvfsp-handoff";
            reg = <0x0 0x11015000 0x0 0x1000>;
            clocks = <&infrasys CLK_INFRA_I2C_APPM>;
            clock-names = "i2c";
            mediatek,infracfg = <&infrasys>;
            #access-controller-cells = <0>;
        };
    };
```

## Documentation/devicetree/bindings/soc/mediatek/mediatek,mt6797-dvfsp-resource-owner.yaml
```yaml
# SPDX-License-Identifier: (GPL-2.0-only OR BSD-2-Clause)
%YAML 1.2
---
$id: http://devicetree.org/schemas/soc/mediatek/mediatek,mt6797-dvfsp-resource-owner.yaml#
$schema: http://devicetree.org/meta-schemas/core.yaml#

title: MediaTek MT6797 DVFSP resource-only owner

maintainers:
  - Gemini Mainline Experiment <gemini-mainline@example.invalid>

description: |
  This optional node binds only the resource-lifetime owner for a future
  MT6797 DVFSP state provider. It retains the four referenced device objects,
  serializes a future transition, and tracks a monotonic generation. It does
  not read clocks, rails, EEM, PTP, or PPM state; it does not access registers,
  call firmware, change clocks or rails, or register a DVFSP state owner.
  Keep the node disabled until every referenced backend has an independently
  reviewed provider contract.

properties:
  compatible:
    const: mediatek,mt6797-dvfsp-resource-owner

  mediatek,clock-backend:
    $ref: /schemas/types.yaml#/definitions/phandle
    description: Protected CPU clock resource object.

  mediatek,bigidvfs-backend:
    $ref: /schemas/types.yaml#/definitions/phandle
    description: BigiDVFS resource object.

  mediatek,thermal:
    $ref: /schemas/types.yaml#/definitions/phandle
    description: EEM/thermal resource object.

  mediatek,calibration-source:
    $ref: /schemas/types.yaml#/definitions/phandle
    description: Read-only calibration source resource object.

  status:
    enum: [ disabled, okay ]

required:
  - compatible
  - mediatek,clock-backend
  - mediatek,bigidvfs-backend
  - mediatek,thermal
  - mediatek,calibration-source

additionalProperties: false

examples:
  - |
    soc {
      dvfsp_resource_owner: dvfsp-resource-owner {
        compatible = "mediatek,mt6797-dvfsp-resource-owner";
        mediatek,clock-backend = <&dvfsp_clock_backend>;
        mediatek,bigidvfs-backend = <&dvfsp_bigidvfs_backend>;
        mediatek,thermal = <&thermal>;
        mediatek,calibration-source = <&dvfsp_handoff>;
        status = "disabled";
      };
    };
```

## Documentation/devicetree/bindings/soc/mediatek/mediatek,mt6797-md1-cold-owner.yaml
```yaml
# SPDX-License-Identifier: (GPL-2.0-only OR BSD-2-Clause)
%YAML 1.2
---
$id: http://devicetree.org/schemas/soc/mediatek/mediatek,mt6797-md1-cold-owner.yaml#
$schema: http://devicetree.org/meta-schemas/core.yaml#

title: MediaTek MT6797 MD1 protected cold-start owner

maintainers:
  - George Whewell <georgerw@gmail.com>

description: |
  One-shot AP ownership of the MD1 cold-start sequence. The recovery watchdog
  and reset-held preflight must be accepted before the named sim pin state is
  selected, then CCIF, power, clocks and the boot-vector release are attempted.
  No default or init pin state is permitted: driver-core selection of either
  would precede the protected cold preflight. Pin selection errors may have
  partially changed hardware and consume the one-shot transaction.
  This state configures both MD1 SIM interfaces; it does not select a SIM slot
  or define the modem-owned VSIM supply voltage.

properties:
  compatible:
    const: mediatek,mt6797-md1-cold-owner

  reg:
    maxItems: 16

  reg-names:
    items:
      - const: infracfg
      - const: ap-ccif
      - const: md-ccif
      - const: ap-cldma-ao
      - const: ap-cldma-pdn
      - const: apmixed
      - const: md-clksw
      - const: md-dcm
      - const: md-peri-misc
      - const: md-l1-a0
      - const: md-top-pll
      - const: md-sys-clk
      - const: md-rgu
      - const: l1-rgu
      - const: boot-vector
      - const: boot-status

  pinctrl-names:
    items:
      - const: sim

  pinctrl-0:
    maxItems: 1

  resets:
    maxItems: 2

  reset-names:
    items:
      - const: cldma-ao
      - const: cldma-pdn

  mediatek,pmic:
    $ref: /schemas/types.yaml#/definitions/phandle
    description: MT6351 PMIC supplier.

  mediatek,boot-watchdog:
    $ref: /schemas/types.yaml#/definitions/phandle
    description: Boot recovery watchdog supplier.

  mediatek,spm:
    $ref: /schemas/types.yaml#/definitions/phandle
    description: SPM power-control supplier.

  mediatek,emi-mpu:
    $ref: /schemas/types.yaml#/definitions/phandle
    description: One-shot MD1 EMI MPU supplier.

  mediatek,experimental-md1-cold-owner:
    type: boolean
    description: Permit the protected one-shot cold-start owner.

  mediatek,stage-cold-reset-held:
    type: boolean
    description: Require the independently observed reset-held preflight.

  mediatek,stage-md1-boot-vector-release:
    type: boolean
    description: Permit the separately guarded boot-vector release.

  mediatek,stage-mainline-firmware-load:
    type: boolean
    description: Request the separately gated native firmware-loading path.

  firmware-name:
    minItems: 1
    maxItems: 3
    description: MD image, followed by optional DSP and ARM7 images in order.

required:
  - compatible
  - reg
  - reg-names
  - pinctrl-names
  - pinctrl-0
  - resets
  - reset-names
  - mediatek,pmic
  - mediatek,boot-watchdog
  - mediatek,spm
  - mediatek,emi-mpu
  - mediatek,experimental-md1-cold-owner
  - mediatek,stage-cold-reset-held
  - mediatek,stage-md1-boot-vector-release

allOf:
  - if:
      required:
        - mediatek,stage-mainline-firmware-load
    then:
      required:
        - firmware-name

additionalProperties: false
...
```

## Documentation/devicetree/bindings/soc/mediatek/mediatek,mt6797-md1-emi-mpu.yaml
```yaml
# SPDX-License-Identifier: (GPL-2.0-only OR BSD-2-Clause)
%YAML 1.2
---
$id: http://devicetree.org/schemas/soc/mediatek/mediatek,mt6797-md1-emi-mpu.yaml#
$schema: http://devicetree.org/meta-schemas/core.yaml#

title: MediaTek MT6797 MD1 one-way secure EMI MPU provider

maintainers:
  - Gemini Mainline Experiment <gemini-mainline@example.invalid>

description: |
  The MT6797 vendor MD1 CCCI path issues the secure-monitor EMI MPU SET call
  for regions 11 and 7 before CCIF, then regions 12, 13, 10 and 14 after
  reset-held power. Vendor supplies no MD1 readback or inverse. The provider
  captures every SET return status and makes any attempted error boot-fatal.
  This node must remain disabled in the shipped board DT. Enabling it also
  needs its explicit read-only module parameter; probe itself issues no SMC.
  It has no modem firmware, boot-vector, reset, power, CCIF or clock control.

properties:
  compatible:
    const: mediatek,mt6797-md1-emi-mpu

  mediatek,experimental-md1-emi-mpu:
    type: boolean
    description: Explicitly permit this one-way provider to probe.

required:
  - compatible

additionalProperties: false
...
```

## Documentation/devicetree/bindings/soc/mediatek/mediatek,mt6797-protected-readback-observer.yaml
```yaml
# SPDX-License-Identifier: (GPL-2.0-only OR BSD-2-Clause)
%YAML 1.2
---
$id: http://devicetree.org/schemas/soc/mediatek/mediatek,mt6797-protected-readback-observer.yaml#
$schema: http://devicetree.org/meta-schemas/core.yaml#

title: MediaTek MT6797 one-shot protected-readback observer

description: |
  This experiment-only observer calls the separately described protected clock
  and BigiDVFS read-only transports once after both have bound. It publishes
  raw records only and is not a state owner, clock or regulator provider, or
  CPU transition consumer.

maintainers:
  - Julien Etienne <julien.etienne@gmail.com>

properties:
  compatible:
    const: mediatek,mt6797-protected-readback-observer

  mediatek,clock-backend:
    $ref: /schemas/types.yaml#/definitions/phandle
    description: MT6797 protected clock readback transport

  mediatek,bigidvfs-backend:
    $ref: /schemas/types.yaml#/definitions/phandle
    description: MT6797 secure BigiDVFS readback transport

  status:
    enum: [ disabled, okay ]

required:
  - compatible
  - mediatek,clock-backend
  - mediatek,bigidvfs-backend

additionalProperties: false
```

## Documentation/devicetree/bindings/soc/mediatek/mediatek,mt6797-spm.yaml
```yaml
# SPDX-License-Identifier: (GPL-2.0-only OR BSD-2-Clause)
%YAML 1.2
---
$id: http://devicetree.org/schemas/soc/mediatek/mediatek,mt6797-spm.yaml#
$schema: http://devicetree.org/meta-schemas/core.yaml#

title: MediaTek MT6797 System Power Manager low-power programs

maintainers:
  - Gemini Mainline Experiment <gemini-mainline@example.invalid>

description: |
  The MT6797 System Power Manager (SPM) runs PCM programs that take the
  SoC through suspend, screen-on idle (SODI) and deep idle.  The programs
  are loaded as firmware files.  The SPM register block is shared with the
  SCPSYS power-domain controller, so this node refers to that syscon
  instead of claiming the registers.

properties:
  compatible:
    const: mediatek,mt6797-spm

  mediatek,spm:
    $ref: /schemas/types.yaml#/definitions/phandle
    description: Phandle to the MT6797 SCPSYS/SPM syscon.

required:
  - compatible
  - mediatek,spm

additionalProperties: false

examples:
  - |
    spm {
        compatible = "mediatek,mt6797-spm";
        mediatek,spm = <&scpsys>;
    };
```

## Documentation/devicetree/bindings/sound/mediatek,mt6351-sound.yaml
```yaml
# SPDX-License-Identifier: (GPL-2.0-only OR BSD-2-Clause)
%YAML 1.2
---
$id: http://devicetree.org/schemas/sound/mediatek,mt6351-sound.yaml#
$schema: http://devicetree.org/meta-schemas/core.yaml#

title: MediaTek MT6351 Audio CODEC

maintainers:
  - KaiChieh Chuang <kaichieh.chuang@mediatek.com>

description:
  MT6351 Audio CODEC is a part of the MediaTek MT6351 PMIC.
  It communicates with the SoC through the MediaTek PMIC wrapper(pwrap).

allOf:
  - $ref: dai-common.yaml#
  - if:
      required:
        - mediatek,jack-detection
    then:
      required:
        - mediatek,accdet-pwm-settings

properties:
  compatible:
    const: mediatek,mt6351-sound

  "#sound-dai-cells":
    const: 0

  vusb33-supply:
    description: Shared 3.3 V rail.

  va18-supply:
    description: 1.8 V analog rail.

  mediatek,jack-detection:
    type: boolean
    description:
      Enable the internal active-low PMIC EINT detector when the machine
      driver attaches an ALSA jack. Supports ACC detection with 2.7 V
      microphone bias and reports headphones and a headset microphone.
      AP GPIO detection, external contact switches and button ADC decoding
      are not described by this property.

  mediatek,accdet-pwm-settings:
    $ref: /schemas/types.yaml#/definitions/uint32-array
    description:
      PWM width and threshold in hardware ticks, falling-delay enable,
      rising delay, and AB=0, AB=1 and AB=3 debounce values. The threshold
      must not exceed the width.
    items:
      - description: PWM width
        minimum: 1
        maximum: 65535
      - description: PWM threshold
        minimum: 1
        maximum: 65535
      - description: Falling-delay enable
        minimum: 0
        maximum: 1
      - description: Rising delay
        minimum: 0
        maximum: 32767
      - description: AB=0 debounce
        minimum: 1
        maximum: 65535
      - description: AB=1 debounce
        minimum: 1
        maximum: 65535
      - description: AB=3 debounce
        minimum: 1
        maximum: 65535

required:
  - compatible
  - "#sound-dai-cells"
  - vusb33-supply
  - va18-supply

unevaluatedProperties: false

examples:
  - |
    sound {
       compatible = "mediatek,mt6351-sound";
       #sound-dai-cells = <0>;
       vusb33-supply = <&mt6351_vusb33_reg>;
       va18-supply = <&mt6351_va18_reg>;
    };
```

## Documentation/devicetree/bindings/sound/mediatek,mt6351.yaml
```yaml
# SPDX-License-Identifier: (GPL-2.0-only OR BSD-2-Clause)
%YAML 1.2
---
$id: http://devicetree.org/schemas/sound/mediatek,mt6351.yaml#
$schema: http://devicetree.org/meta-schemas/core.yaml#

title: MediaTek MT6351 audio codec

maintainers:
  - Tzung-Bi Shih <tzungbi@chromium.org>
  - Jiaxin Yu <jiaxin.yu@mediatek.com>

description:
  The MT6351 codec is an MFD child of the MT6351 PMIC. Communication with the
  SoC uses the MediaTek PMIC wrapper owned by the parent PMIC device.

properties:
  compatible:
    const: mediatek,mt6351-sound

required:
  - compatible

additionalProperties: false

examples:
  - |
    pmic {
        audio-codec {
            compatible = "mediatek,mt6351-sound";
        };
    };

...
```
