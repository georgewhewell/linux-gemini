## Documentation/devicetree/bindings/regulator/mediatek,i2c_lcd_bias.yaml
```yaml
# SPDX-License-Identifier: GPL-2.0-only OR BSD-2-Clause
%YAML 1.2
---
$id: http://devicetree.org/schemas/regulator/mediatek,i2c_lcd_bias.yaml#
$schema: http://devicetree.org/meta-schemas/core.yaml#

title: Planet Gemini PDA LP3101 display-bias regulator

maintainers:
  - Julien Etienne <julien.etienne@gmail.com>

description: |
  The Planet vendor kernel identifies the Gemini display-bias controller as
  LP3101 on I2C1 address 0x3e.  The relevant vendor sources are
  arch/arm64/boot/dts/cust_i2c.dtsi and
  drivers/misc/mediatek/gpio/lp3101.c.  It enables the positive and negative
  rails independently, waits 20 ms after both rails are enabled, then writes
  0x0f to registers 0x00 and 0x01.  The vendor DT names this device
  "mediatek,i2c_lcd_bias".  This binding retains that exact compatible string;
  no independently sourced replacement compatible is known.

  No LP3101 data sheet or output-voltage specification is available in the
  recovered source.  Consequently this binding exposes only the two switched
  outputs and deliberately has no voltage-range properties beyond the common
  regulator constraints.

allOf:
  - $ref: /schemas/regulator/regulator.yaml#

properties:
  compatible:
    const: mediatek,i2c_lcd_bias

  reg:
    maxItems: 1

  outp:
    type: object
    $ref: /schemas/regulator/regulator.yaml#
    unevaluatedProperties: false
    description: Positive display-bias output.
    properties:
      enable-gpios:
        maxItems: 1
    required:
      - regulator-name
      - enable-gpios

  outn:
    type: object
    $ref: /schemas/regulator/regulator.yaml#
    unevaluatedProperties: false
    description: Negative display-bias output.
    properties:
      enable-gpios:
        maxItems: 1
    required:
      - regulator-name
      - enable-gpios

required:
  - compatible
  - reg
  - outp
  - outn

unevaluatedProperties: false

examples:
  - |
    #include <dt-bindings/gpio/gpio.h>

    i2c {
        #address-cells = <1>;
        #size-cells = <0>;

        regulator@3e {
            compatible = "mediatek,i2c_lcd_bias";
            reg = <0x3e>;

            outp {
                regulator-name = "outp";
                enable-gpios = <&gpio 60 GPIO_ACTIVE_HIGH>;
            };

            outn {
                regulator-name = "outn";
                enable-gpios = <&gpio 251 GPIO_ACTIVE_HIGH>;
            };
        };
    };

...
```

## Documentation/devicetree/bindings/regulator/mediatek,mt6351-regulator.yaml
```yaml
# SPDX-License-Identifier: (GPL-2.0 OR BSD-2-Clause)
%YAML 1.2
---
$id: http://devicetree.org/schemas/regulator/mediatek,mt6351-regulator.yaml#
$schema: http://devicetree.org/meta-schemas/core.yaml#

title: MediaTek MT6351 regulators

maintainers:
  - Julien Etienne <julien.etienne@gmail.com>

description: |
  The MT6351 PMIC provides nine buck regulators and 30 independently
  controlled LDO regulator outputs. The regulators node is a child of the
  MT6351 MFD node. Regulator nodes are named for their hardware rail using
  buck-<name> and ldo-<name>.

properties:
  compatible:
    const: mediatek,mt6351-regulator

patternProperties:
  "^buck-v(core|gpu|md1|modem|pa|s1|s2|sram-md|sram-proc)$":
    type: object
    $ref: regulator.yaml#
    unevaluatedProperties: false

  "^ldo-v(a10|a18|bif28|cama|camd|camio|cn18|cn28|cn33-bt|cn33-wifi|dram|efuse|emc|gp3|ibr|io18|io28|ldo28|ldo28-1|mc|mch|mipi|rf12|rf18|sim1|sim2|tcxo24|tcxo28|usb33|xo22)$":
    type: object
    $ref: regulator.yaml#
    unevaluatedProperties: false

required:
  - compatible

additionalProperties: false

examples:
  - |
    pmic {
      regulators {
        compatible = "mediatek,mt6351-regulator";

        mt6351_vemc_reg: ldo-vemc {
          regulator-name = "vemc";
          regulator-min-microvolt = <3000000>;
          regulator-max-microvolt = <3300000>;
        };

        mt6351_vmch_reg: ldo-vmch {
          regulator-name = "vmch";
          regulator-min-microvolt = <3000000>;
          regulator-max-microvolt = <3300000>;
        };

        mt6351_vmc_reg: ldo-vmc {
          regulator-name = "vmc";
          regulator-min-microvolt = <1200000>;
          regulator-max-microvolt = <3300000>;
        };
      };
    };
```

## Documentation/devicetree/bindings/regulator/mediatek,mt6797-bigidvfs-sram.yaml
```yaml
# SPDX-License-Identifier: (GPL-2.0-only OR BSD-2-Clause)
%YAML 1.2
---
$id: http://devicetree.org/schemas/regulator/mediatek,mt6797-bigidvfs-sram.yaml#
$schema: http://devicetree.org/meta-schemas/core.yaml#

title: MediaTek MT6797 BigiDVFS secure SRAM regulator

maintainers:
  - Julien Etienne <julien.etienne@gmail.com>

description:
  The MT6797 MP2 SRAM LDO is controlled by a secure BigiDVFS service. The
  service can read and set its voltage selector, but provides no verified
  status or disable operation. The node must remain disabled until firmware
  compatibility and the missing lifecycle operations are resolved.

properties:
  compatible:
    const: mediatek,mt6797-bigidvfs-sram

  regulator-name: true

  regulator-min-microvolt:
    const: 600000

  regulator-max-microvolt:
    const: 1200000

required:
  - compatible
  - regulator-name
  - regulator-min-microvolt
  - regulator-max-microvolt

allOf:
  - $ref: regulator.yaml#

unevaluatedProperties: false

examples:
  - |
    vsram_big: regulator-sram-big {
        compatible = "mediatek,mt6797-bigidvfs-sram";
        regulator-name = "vsram-big";
        regulator-min-microvolt = <600000>;
        regulator-max-microvolt = <1200000>;
        status = "disabled";
    };

...
```

## Documentation/devicetree/bindings/regulator/mediatek,mt6797-cpu-sram-regulator.yaml
```yaml
# SPDX-License-Identifier: (GPL-2.0-only OR BSD-2-Clause)
%YAML 1.2
---
$id: http://devicetree.org/schemas/regulator/mediatek,mt6797-cpu-sram-regulator.yaml#
$schema: http://devicetree.org/meta-schemas/core.yaml#

title: MediaTek MT6797 CPU SRAM LDOs

maintainers:
  - George Whewell <georgerw@gmail.com>

description: |
  Eight LDOs in INFRACFG supply the A53 CPU SRAM. The LL/L/CCI voltage
  policy programs them together as one rail, in 25 mV steps from 1.0 to
  1.2 V. These are separate from the MT6351 PMIC SRAM regulator and the
  secure-firmware-controlled A72 SRAM LDO. Access requires the stopped
  DVFSP firmware handoff and its hardware semaphore. All eight LDOs must
  remain enabled.

allOf:
  - $ref: regulator.yaml#

properties:
  compatible:
    const: mediatek,mt6797-cpu-sram-regulator

  mediatek,infracfg:
    $ref: /schemas/types.yaml#/definitions/phandle
    description: INFRACFG syscon containing CPULDO_CTRL0/1/2.

  clocks:
    maxItems: 1

  clock-names:
    const: i2c

  access-controllers:
    maxItems: 1

  regulator-min-microvolt:
    minimum: 1000000
    maximum: 1200000

  regulator-max-microvolt:
    minimum: 1000000
    maximum: 1200000

  regulator-always-on: true

required:
  - compatible
  - mediatek,infracfg
  - clocks
  - clock-names
  - access-controllers
  - regulator-always-on

unevaluatedProperties: false

examples:
  - |
    #include <dt-bindings/clock/mt6797-clk.h>
    regulator-cpu-sram {
        compatible = "mediatek,mt6797-cpu-sram-regulator";
        mediatek,infracfg = <&infrasys>;
        clocks = <&infrasys CLK_INFRA_I2C_APPM>;
        clock-names = "i2c";
        access-controllers = <&dvfsp_handoff>;
        regulator-name = "vsram-a53-cci";
        regulator-min-microvolt = <1000000>;
        regulator-max-microvolt = <1200000>;
        regulator-always-on;
    };
```

## Documentation/devicetree/bindings/regulator/onsemi,fan49101.yaml
```yaml
# SPDX-License-Identifier: (GPL-2.0-only OR BSD-2-Clause)
%YAML 1.2
---
$id: http://devicetree.org/schemas/regulator/onsemi,fan49101.yaml#
$schema: http://devicetree.org/meta-schemas/core.yaml#

title: onsemi FAN49101 buck-boost regulator

maintainers:
  - Julien Etienne <julien.etienne@gmail.com>

description: |
  The FAN49101 is an I2C-controlled buck-boost regulator with one output.
  The output selector uses 64 codes from 603 mV in 12.826 mV steps. Its
  register protocol is distinct from the FAN53555 family.

properties:
  compatible:
    const: onsemi,fan49101

  reg:
    maxItems: 1

  regulators:
    type: object
    additionalProperties: false
    properties:
      vout:
        type: object
        $ref: /schemas/regulator/regulator.yaml#
        unevaluatedProperties: false

required:
  - compatible
  - reg
  - regulators

additionalProperties: false

examples:
  - |
    i2c {
      #address-cells = <1>;
      #size-cells = <0>;

      regulator@70 {
        compatible = "onsemi,fan49101";
        reg = <0x70>;

        regulators {
          vout {
            regulator-name = "fan49101-vout";
            regulator-min-microvolt = <603000>;
            regulator-max-microvolt = <1413000>;
          };
        };
      };
    };
```

## Documentation/devicetree/bindings/regulator/richtek,rt5735.yaml
```yaml
# SPDX-License-Identifier: GPL-2.0-only OR BSD-2-Clause
%YAML 1.2
---
$id: http://devicetree.org/schemas/regulator/richtek,rt5735.yaml#
$schema: http://devicetree.org/meta-schemas/core.yaml#

title: Richtek RT5735 Step-Down Buck Converter

description: |
  The RT5735 is an I2C-controlled buck converter. This binding describes the
  VSEL0 output used by the MT6797 Gemini GPU. The VSEL0 voltage selector has
  128 linear steps from 600 mV to 1.39375 V in 6.25 mV increments.

allOf:
  - $ref: regulator.yaml#

properties:
  compatible:
    const: richtek,rt5735

  reg:
    maxItems: 1

required:
  - compatible
  - reg

unevaluatedProperties: false

examples:
  - |
    i2c {
      #address-cells = <1>;
      #size-cells = <0>;

      regulator@1c {
        compatible = "richtek,rt5735";
        reg = <0x1c>;
        regulator-name = "vgpu";
        regulator-min-microvolt = <600000>;
        regulator-max-microvolt = <1393750>;
        regulator-boot-on;
      };
    };
```

## Documentation/devicetree/bindings/remoteproc/mediatek,mt6797-md1.yaml
```yaml
# SPDX-License-Identifier: (GPL-2.0-only OR BSD-2-Clause)
%YAML 1.2
---
$id: http://devicetree.org/schemas/remoteproc/mediatek,mt6797-md1.yaml#
$schema: http://devicetree.org/meta-schemas/core.yaml#

title: MediaTek MT6797 MD1 modem subsystem

maintainers:
  - George Whewell <georgerw@gmail.com>

description:
  The MT6797 contains an integrated modem processor.  The application
  processor communicates with it through CLDMA and CCIF register blocks.
  The modem also owns private memory and a shared-memory region.  This
  binding describes those resources only; it does not define a firmware or
  power-on ABI.

$nodename:
  pattern: "^remoteproc@[0-9a-f]+$"

properties:
  compatible:
    const: mediatek,mt6797-md1

  reg:
    items:
      - description: Application-processor CLDMA always-on registers
      - description: Modem CLDMA always-on registers
      - description: Application-processor CLDMA power-down registers
      - description: Modem CLDMA power-down registers
      - description: Application-processor CCIF registers
      - description: Modem CCIF registers

  reg-names:
    items:
      - const: ap-ao
      - const: md-ao
      - const: ap-pdn
      - const: md-pdn
      - const: ap-ccif
      - const: md-ccif

  interrupts:
    items:
      - description: CLDMA interrupt
      - description: CCIF interrupt
      - description: Modem watchdog interrupt

  interrupt-names:
    items:
      - const: cldma
      - const: ccif
      - const: wdt

  clocks:
    items:
      - description: Application-processor CCIF interface clock
      - description: Modem CCIF interface clock

  clock-names:
    items:
      - const: ccif-ap
      - const: ccif-md

  resets:
    items:
      - description: CLDMA power-down register-domain reset
      - description: CLDMA always-on register-domain reset

  reset-names:
    items:
      - const: cldma-pdn
      - const: cldma-ao

  mediatek,spm:
    $ref: /schemas/types.yaml#/definitions/phandle
    description:
      Phandle to the MT6797 SPM syscon. The ownership core only observes the
      two read-only power-status registers; this property does not make MD1 a
      generic power-domain consumer or authorize a power-state transition.

  memory-region:
    description:
      Reserved memory for the modem and for application-processor/modem
      communication.  Both regions are required before the modem can be
      enabled.
    minItems: 2
    maxItems: 2

  memory-region-names:
    items:
      - const: md1
      - const: shared

required:
  - compatible
  - reg
  - reg-names
  - interrupts
  - interrupt-names
  - clocks
  - clock-names
  - resets
  - reset-names
  - mediatek,spm

dependencies:
  memory-region: [memory-region-names]
  memory-region-names: [memory-region]

additionalProperties: false

examples:
  - |
    #include <dt-bindings/clock/mt6797-clk.h>
    #include <dt-bindings/interrupt-controller/arm-gic.h>
    #include <dt-bindings/reset/mt6797-resets.h>

    remoteproc@10014000 {
        compatible = "mediatek,mt6797-md1";
        reg = <0x10014000 0x1e00>,
              <0x10015000 0x1e00>,
              <0x10219000 0x1e00>,
              <0x1021a000 0x1e00>,
              <0x10209000 0x1000>,
              <0x1020a000 0x1000>;
        reg-names = "ap-ao", "md-ao", "ap-pdn", "md-pdn",
                    "ap-ccif", "md-ccif";
        interrupts = <GIC_SPI 265 IRQ_TYPE_LEVEL_HIGH>,
                     <GIC_SPI 147 IRQ_TYPE_LEVEL_LOW>,
                     <GIC_SPI 266 IRQ_TYPE_EDGE_FALLING>;
        interrupt-names = "cldma", "ccif", "wdt";
        clocks = <&infracfg CLK_INFRA_CCIF_AP>,
                 <&infracfg CLK_INFRA_CCIF_MD>;
        clock-names = "ccif-ap", "ccif-md";
        resets = <&infracfg MT6797_INFRA_CLDMA_RST>,
                 <&infracfg MT6797_INFRA_CLDMA_AO_RST>;
        reset-names = "cldma-pdn", "cldma-ao";
        mediatek,spm = <&scpsys>;
        status = "disabled";
    };

...
```
