## Documentation/devicetree/bindings/soc/mediatek/mediatek,mt6797-a72-power.yaml
```yaml
# SPDX-License-Identifier: (GPL-2.0-only OR BSD-2-Clause)
%YAML 1.2
---
$id: http://devicetree.org/schemas/soc/mediatek/mediatek,mt6797-a72-power.yaml#
$schema: http://devicetree.org/meta-schemas/core.yaml#

title: MediaTek MT6797 Cortex-A72 cluster power coordination

maintainers:
  - Gemini Mainline Experiment <gemini-mainline@example.invalid>

description: |
  The MT6797 Cortex-A72 cluster requires coordination between the external
  processor regulator, SPM isolation, MCUCFG clock controls, TOPRGU reset,
  and secure firmware before PSCI can start a CPU in that cluster.

properties:
  compatible:
    const: mediatek,mt6797-a72-power

  mediatek,spm:
    $ref: /schemas/types.yaml#/definitions/phandle
    description: Phandle to the MT6797 SCPSYS/SPM syscon.

  cpus:
    minItems: 2
    maxItems: 2
    description: Phandles to the two CPUs powered through this resource path.

  vproc-big-supply:
    description: External processor supply for the Cortex-A72 cluster.

  sram-big-supply:
    description:
      Secure BigiDVFS SRAM supply for the Cortex-A72 cluster. The preflight
      remains blocked until this provider supports truthful status and disable.

  clocks:
    maxItems: 1
    description: Read-only MP2 clock exposed by the CPU clock provider.

  clock-names:
    const: mp2

  resets:
    maxItems: 1

  reset-names:
    const: pwrap

required:
  - compatible
  - mediatek,spm
  - cpus
  - vproc-big-supply
  - sram-big-supply
  - clocks
  - clock-names
  - resets
  - reset-names

additionalProperties: false

examples:
  - |
    #include <dt-bindings/clock/mt6797-clk.h>
    #include <dt-bindings/reset/mt6797-resets.h>

    a72-power {
        compatible = "mediatek,mt6797-a72-power";
        mediatek,spm = <&scpsys>;
        cpus = <&cpu8>, <&cpu9>;
        vproc-big-supply = <&da9214_buckb>;
        sram-big-supply = <&vsram_big>;
        clocks = <&cpuclk CLK_MCU_MP2>;
        clock-names = "mp2";
        resets = <&watchdog MT6797_TOPRGU_PWRAP_SPI_CTL_RST>;
        reset-names = "pwrap";
        status = "disabled";
    };
...
```

## Documentation/devicetree/bindings/soc/mediatek/mediatek,mt6797-bigidvfs-backend.yaml
```yaml
# SPDX-License-Identifier: (GPL-2.0-only OR BSD-2-Clause)
%YAML 1.2
---
$id: http://devicetree.org/schemas/soc/mediatek/mediatek,mt6797-bigidvfs-backend.yaml#
$schema: http://devicetree.org/meta-schemas/core.yaml#

title: MediaTek MT6797 BigiDVFS secure readback transport

description: |
  The MT6797 B-cluster clock and rail state is owned by a secure BigiDVFS
  service. This optional transport exposes only the documented read-only
  secure-register service and remains disabled until its target firmware
  variant and return contract are independently validated. It is not a
  regulator, clock provider, DVFSP state owner, or writable secure backend.

maintainers:
  - Julien Etienne <julien.etienne@gmail.com>

properties:
  compatible:
    const: mediatek,mt6797-bigidvfs-backend

  method:
    const: smc

  status:
    enum: [ disabled, okay ]

required:
  - compatible
  - method

additionalProperties: false

examples:
  - |
    soc {
      dvfsp_bigidvfs_backend: dvfsp-bigidvfs-backend {
        compatible = "mediatek,mt6797-bigidvfs-backend";
        method = "smc";
        status = "disabled";
      };
    };
```

## Documentation/devicetree/bindings/soc/mediatek/mediatek,mt6797-btif-pio.yaml
```yaml
# SPDX-License-Identifier: (GPL-2.0-only OR BSD-2-Clause)
%YAML 1.2
---
$id: http://devicetree.org/schemas/soc/mediatek/mediatek,mt6797-btif-pio.yaml#
$schema: http://devicetree.org/meta-schemas/core.yaml#

title: MediaTek MT6797 BTIF PIO transport

maintainers:
  - George Whewell <georgerw@gmail.com>

description: |
  PIO-only transport for the MT6797 BTIF core. It uses the single BTIF core
  register window, its level-low interrupt, and CLK_INFRA_BTIF. The provider
  deliberately has no APDMA resource or clock; CONSYS lifecycle and firmware
  ownership belong to its consumers.

properties:
  compatible:
    const: mediatek,mt6797-btif-pio

  reg:
    maxItems: 1
    description: The BTIF core window at 0x1100c000, sized 0x1000.

  interrupts:
    maxItems: 1
    description: The BTIF core GIC SPI 130, level-low.

  clocks:
    maxItems: 1
    description: The MT6797 infrasys CLK_INFRA_BTIF clock.

  clock-names:
    const: btifc

required:
  - compatible
  - reg
  - interrupts
  - clocks
  - clock-names

additionalProperties: false

examples:
  - |
    #include <dt-bindings/clock/mt6797-clk.h>
    #include <dt-bindings/interrupt-controller/arm-gic.h>
    #include <dt-bindings/interrupt-controller/irq.h>

    / {
        #address-cells = <2>;
        #size-cells = <2>;

        gic: interrupt-controller {
            interrupt-controller;
            #interrupt-cells = <3>;
        };

        btif_pio: serial@1100c000 {
            compatible = "mediatek,mt6797-btif-pio";
            reg = <0 0x1100c000 0 0x1000>;
            interrupts = <GIC_SPI 130 IRQ_TYPE_LEVEL_LOW>;
            interrupt-parent = <&gic>;
            clocks = <&infrasys CLK_INFRA_BTIF>;
            clock-names = "btifc";
            status = "disabled";
        };
    };
...
```

## Documentation/devicetree/bindings/soc/mediatek/mediatek,mt6797-btif-transport.yaml
```yaml
# SPDX-License-Identifier: (GPL-2.0-only OR BSD-2-Clause)
%YAML 1.2
---
$id: http://devicetree.org/schemas/soc/mediatek/mediatek,mt6797-btif-transport.yaml#
$schema: http://devicetree.org/meta-schemas/core.yaml#

title: MediaTek MT6797 experimental BTIF/APDMA byte transport

maintainers:
  - George Whewell <georgerw@gmail.com>

description: |
  MT6797 BTIF is the byte transport shared by the vendor CONSYS stack. This
  experimental binding describes its core, two APDMA virtual-FIFO windows,
  clocks and interrupts. It does not describe pads, firmware, CONSYS power
  votes, function control, or STP full-mode ownership.

  Keep the node disabled. Even when a test overlay sets status to "okay", the
  driver refuses to access hardware unless this node has
  mediatek,experimental-transport and its module parameter is enabled. The
  double gate prevents an ordinary DT enable from powering clocks or starting
  DMA while the CONSYS ownership contract remains under development.

properties:
  compatible:
    const: mediatek,mt6797-btif-transport

  reg:
    maxItems: 3
    description: |
      BTIF core, TX APDMA virtual-FIFO, and RX APDMA virtual-FIFO register
      windows, in that order.

  reg-names:
    items:
      - const: core
      - const: tx-dma
      - const: rx-dma

  interrupts:
    items:
      - description: BTIF core interrupt
      - description: BTIF TX APDMA interrupt
      - description: BTIF RX APDMA interrupt

  interrupt-names:
    items:
      - const: core
      - const: tx
      - const: rx

  clocks:
    minItems: 2
    maxItems: 2

  clock-names:
    items:
      - const: btifc
      - const: apdmac

  mediatek,consys:
    $ref: /schemas/types.yaml#/definitions/phandle
    description: Phandle to the shared MT6797 CONSYS owner.

  mediatek,experimental-transport:
    type: boolean
    description: |
      Explicitly permit a hand-authored experiment when the module parameter
      enable_experimental_transport=1 is also present. This property does not
      establish pad mux, firmware, or CONSYS power ownership.

required:
  - compatible
  - reg
  - reg-names
  - interrupts
  - interrupt-names
  - clocks
  - clock-names
  - mediatek,consys

additionalProperties: false

examples:
  - |
    #include <dt-bindings/clock/mt6797-clk.h>
    #include <dt-bindings/interrupt-controller/arm-gic.h>
    #include <dt-bindings/interrupt-controller/irq.h>

    btif-transport@1100c000 {
        compatible = "mediatek,mt6797-btif-transport";
        reg = <0 0x1100c000 0 0x1000>,
              <0 0x11000a00 0 0x80>,
              <0 0x11000a80 0 0x80>;
        reg-names = "core", "tx-dma", "rx-dma";
        interrupts = <GIC_SPI 130 IRQ_TYPE_LEVEL_LOW>,
                     <GIC_SPI 116 IRQ_TYPE_LEVEL_LOW>,
                     <GIC_SPI 117 IRQ_TYPE_LEVEL_LOW>;
        interrupt-names = "core", "tx", "rx";
        clocks = <&infrasys CLK_INFRA_BTIF>,
                 <&infrasys CLK_INFRA_AP_DMA>;
        clock-names = "btifc", "apdmac";
        mediatek,consys = <&consys>;
        status = "disabled";
    };
...
```

## Documentation/devicetree/bindings/soc/mediatek/mediatek,mt6797-btif.yaml
```yaml
# SPDX-License-Identifier: (GPL-2.0-only OR BSD-2-Clause)
%YAML 1.2
---
$id: http://devicetree.org/schemas/soc/mediatek/mediatek,mt6797-btif.yaml#
$schema: http://devicetree.org/meta-schemas/core.yaml#

title: MediaTek MT6797 BTIF and APDMA resource inventory

maintainers:
  - Gemini Mainline Experiment <gemini-mainline@example.invalid>

description: |
  The MT6797 Bluetooth interface is the host transport for shared CONSYS
  traffic. This binding currently describes only the BTIF core, its TX/RX
  APDMA resources, their clocks and interrupts, and the parent CONSYS
  relationship. The driver is inventory-only: it does not map or access
  registers, enable clocks, request interrupts, allocate DMA, request CONSYS
  power, expose a userspace ABI, or instantiate STP.

properties:
  compatible:
    const: mediatek,mt6797-btif

  reg:
    items:
      - description: BTIF core register window
      - description: BTIF TX APDMA register window
      - description: BTIF RX APDMA register window

  reg-names:
    items:
      - const: core
      - const: tx-dma
      - const: rx-dma

  interrupts:
    items:
      - description: BTIF core interrupt
      - description: BTIF TX APDMA interrupt
      - description: BTIF RX APDMA interrupt

  interrupt-names:
    items:
      - const: core
      - const: tx
      - const: rx

  clocks:
    minItems: 2
    maxItems: 2

  clock-names:
    items:
      - const: btifc
      - const: apdmac

  mediatek,consys:
    $ref: /schemas/types.yaml#/definitions/phandle
    description: Phandle to the shared MT6797 CONSYS resource owner.

  status:
    enum: [ disabled, okay ]

required:
  - compatible
  - reg
  - reg-names
  - interrupts
  - interrupt-names
  - clocks
  - clock-names
  - mediatek,consys

additionalProperties: false
```

## Documentation/devicetree/bindings/soc/mediatek/mediatek,mt6797-consys-emi-mpu.yaml
```yaml
# SPDX-License-Identifier: (GPL-2.0-only OR BSD-2-Clause)
%YAML 1.2
---
$id: http://devicetree.org/schemas/soc/mediatek/mediatek,mt6797-consys-emi-mpu.yaml#
$schema: http://devicetree.org/meta-schemas/core.yaml#

title: MediaTek MT6797 CONSYS shared-EMI MPU owner

maintainers:
  - George Whewell <georgerw@gmail.com>

description: |
  The MT6797 vendor CONSYS setup permanently protects the upper half of its
  2 MiB shared reservation through EMI MPU region 19, configures the
  CONSYS-to-AP remap field, and clears a 343 KiB window. The vendor source has
  no inverse operation. The provider validates its resources at probe and
  performs the one-way ownership transaction only when a CONSYS consumer
  claims it. It also controls the separately reversible 512 KiB Wi-Fi window.

properties:
  compatible:
    const: mediatek,mt6797-consys-emi-mpu

  reg:
    items:
      - description: EMI MPU aperture used by the vendor secure firmware ABI.
      - description: TOPCKGEN aperture containing the CONSYS remap register.

  reg-names:
    items:
      - const: emi
      - const: topckgen

  memory-region:
    maxItems: 1
    description: The exact 2 MiB, 2 MiB-aligned, no-map CONSYS reservation.

  memory-region-names:
    const: shared

required:
  - compatible
  - reg
  - reg-names
  - memory-region
  - memory-region-names

additionalProperties: false

examples:
  - |
    / {
        #address-cells = <2>;
        #size-cells = <2>;

        reserved-memory {
            #address-cells = <2>;
            #size-cells = <2>;
            ranges;

            consys_reserved_memory: wifi-memory {
                size = <0 0x200000>;
                alignment = <0 0x200000>;
                no-map;
            };
        };

        emi-mpu@10203000 {
            compatible = "mediatek,mt6797-consys-emi-mpu";
            reg = <0 0x10203000 0 0x1000>,
                  <0 0x10000000 0 0x2000>;
            reg-names = "emi", "topckgen";
            memory-region = <&consys_reserved_memory>;
            memory-region-names = "shared";
            status = "disabled";
        };
    };
...
```

## Documentation/devicetree/bindings/soc/mediatek/mediatek,mt6797-consys-runtime-controller.yaml
```yaml
# SPDX-License-Identifier: (GPL-2.0-only OR BSD-2-Clause)
%YAML 1.2
---
$id: http://devicetree.org/schemas/soc/mediatek/mediatek,mt6797-consys-runtime-controller.yaml#
$schema: http://devicetree.org/meta-schemas/core.yaml#

title: MediaTek MT6797 gated CONSYS STP-bootstrap controller

maintainers:
  - George Whewell <georgerw@gmail.com>

description: |
  This is a deliberately separate, one-shot consumer of the MT6797 CONSYS
  runtime and BTIF PIO platform experiments. It creates managed supplier
  links, then remains dormant until an in-kernel caller invokes its explicitly
  gated start operation. That operation owns only the documented mandatory
  STP query-default, set-full, host full-STP handoff, 10 ms delay, and
  query-full verification sequence.

  Keep this node disabled in the shipped Gemini DT. A hand-authored overlay
  must enable it, set mediatek,experimental-bootstrap, enable each referenced
  provider's independent gates, and set the controller boot parameter. This
  binding does not establish clock, pad, reset-release, AFE, firmware-patch,
  or radio-function ownership. The controller registers no GNSS, HCI, Wi-Fi,
  FM, or userspace endpoint.

properties:
  compatible:
    const: mediatek,mt6797-consys-runtime-controller

  mediatek,runtime-provider:
    $ref: /schemas/types.yaml#/definitions/phandle
    description: |
      A separately enabled mediatek,mt6797-consys-runtime provider holding the
      exclusive lifecycle lease through its bounded identity prefix.

  mediatek,btif-provider:
    $ref: /schemas/types.yaml#/definitions/phandle
    description: |
      A separately enabled mediatek,mt6797-btif-pio platform adapter with its
      BTIF IRQ registered but disabled.

  mediatek,experimental-bootstrap:
    type: boolean
    description: |
      Explicitly permit this dormant coordinator to bind when its independent
      default-false boot parameter is also supplied. It does not itself start
      the handover.

required:
  - compatible
  - mediatek,runtime-provider
  - mediatek,btif-provider
  - mediatek,experimental-bootstrap

additionalProperties: false

examples:
  - |
    consys-stp-bootstrap {
        compatible = "mediatek,mt6797-consys-runtime-controller";
        mediatek,runtime-provider = <&consys_runtime>;
        mediatek,btif-provider = <&btif_pio>;
        mediatek,experimental-bootstrap;
        status = "disabled";
    };
...
```
