## drivers/gnss/Kconfig
```kconfig
# SPDX-License-Identifier: GPL-2.0-only
#
# GNSS receiver configuration
#

menuconfig GNSS
	tristate "GNSS receiver support"
	help
	  Say Y here if you have a GNSS receiver (e.g. a GPS receiver).

	  To compile this driver as a module, choose M here: the module will
	  be called gnss.

if GNSS

config GNSS_SERIAL
	tristate

config GNSS_MTK_SERIAL
	tristate "Mediatek GNSS receiver support"
	depends on SERIAL_DEV_BUS
	select GNSS_SERIAL
	help
	  Say Y here if you have a Mediatek-based GNSS receiver which uses a
	  serial interface.

	  To compile this driver as a module, choose M here: the module will
	  be called gnss-mtk.

	  If unsure, say N.

config GNSS_MTK_CONSYS
	tristate "MediaTek CONSYS GNSS full-STP endpoint"
	depends on MTK_MT6797_CONSYS_STP_SESSION
	depends on MTK_MT6797_CONSYS_INVENTORY && REGULATOR
	help
	  Build the ordinary Linux GNSS endpoint for STP task 2 of MT6797 CONSYS.
	  The canonical CONSYS owner supplies the active session, WMT GPS function
	  control, and shared transport retry handling. The platform child manages
	  its optional LNA supply and powers GPS only while the endpoint is open.
	  Receiver bytes are exposed unchanged; interpreting a supported receiver
	  protocol is a userspace responsibility.

	  If unsure, say N.

config GNSS_MTK_CONSYS_KUNIT_TEST
	tristate "KUnit tests for the MediaTek CONSYS GNSS endpoint"
	depends on KUNIT=y
	depends on GNSS_MTK_CONSYS=y
	help
	  Exercise the hardware-free GNSS endpoint lifecycle, opaque full-STP
	  channel-2 stream, transmit failure fencing, and recovery contract using
	  fake callbacks. No Device Tree node, WMT command, firmware image, or
	  hardware is used.
	  This test has no dependency on a MediaTek platform at run time.

config GNSS_SIRF_SERIAL
	tristate "SiRFstar GNSS receiver support"
	depends on SERIAL_DEV_BUS
	help
	  Say Y here if you have a SiRFstar-based GNSS receiver which uses a
	  serial interface.

	  To compile this driver as a module, choose M here: the module will
	  be called gnss-sirf.

	  If unsure, say N.

config GNSS_UBX_SERIAL
	tristate "u-blox GNSS receiver support"
	depends on SERIAL_DEV_BUS
	select GNSS_SERIAL
	help
	  Say Y here if you have a u-blox GNSS receiver which uses a serial
	  interface.

	  To compile this driver as a module, choose M here: the module will
	  be called gnss-ubx.

	  If unsure, say N.

config GNSS_USB
	tristate "USB GNSS receiver support"
	depends on USB
	help
	  Say Y here if you have a GNSS receiver which uses a USB interface.

	  To compile this driver as a module, choose M here: the module will
	  be called gnss-usb.

	  If unsure, say N.

endif # GNSS
```
