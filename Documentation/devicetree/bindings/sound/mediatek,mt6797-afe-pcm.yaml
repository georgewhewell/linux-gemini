## Documentation/devicetree/bindings/sound/mediatek,mt6797-afe-pcm.yaml
```yaml
# SPDX-License-Identifier: (GPL-2.0-only OR BSD-2-Clause)
%YAML 1.2
---
$id: http://devicetree.org/schemas/sound/mediatek,mt6797-afe-pcm.yaml#
$schema: http://devicetree.org/meta-schemas/core.yaml#

title: MediaTek MT6797 Audio Front End PCM controller

maintainers:
  - Tzung-Bi Shih <tzungbi@chromium.org>
  - Jiaxin Yu <jiaxin.yu@mediatek.com>

properties:
  compatible:
    const: mediatek,mt6797-audio

  reg:
    maxItems: 1

  interrupts:
    maxItems: 1

  power-domains:
    maxItems: 1

  clocks:
    minItems: 8
    maxItems: 8

  clock-names:
    items:
      - const: infra_sys_audio_clk
      - const: infra_sys_audio_26m
      - const: mtkaif_26m_clk
      - const: top_mux_audio
      - const: top_mux_aud_intbus
      - const: top_sys_pll3_d4
      - const: top_sys_pll1_d4
      - const: top_clk26m_clk

required:
  - compatible
  - reg
  - interrupts
  - power-domains
  - clocks
  - clock-names

additionalProperties: false
```

## Documentation/devicetree/bindings/sound/mediatek,mt6797-mt6351.yaml
```yaml
# SPDX-License-Identifier: (GPL-2.0-only OR BSD-2-Clause)
%YAML 1.2
---
$id: http://devicetree.org/schemas/sound/mediatek,mt6797-mt6351.yaml#
$schema: http://devicetree.org/meta-schemas/core.yaml#

title: MediaTek MT6797 sound card with MT6351 codec

maintainers:
  - Tzung-Bi Shih <tzungbi@chromium.org>
  - Jiaxin Yu <jiaxin.yu@mediatek.com>

properties:
  compatible:
    const: mediatek,mt6797-mt6351-sound

  model:
    $ref: /schemas/types.yaml#/definitions/string
    description: User-visible name of the sound card.

  audio-widgets:
    $ref: /schemas/types.yaml#/definitions/non-unique-string-array
    description:
      User-visible endpoint widgets. Each widget is described by a pair of
      strings containing its type and name.

  audio-routing:
    $ref: /schemas/types.yaml#/definitions/non-unique-string-array
    description:
      Connections between board endpoints and codec pins. Each connection is
      a pair of strings containing its sink and source.

  mediatek,platform:
    $ref: /schemas/types.yaml#/definitions/phandle
    description: Phandle to the MT6797 audio front end.

  mediatek,audio-codec:
    $ref: /schemas/types.yaml#/definitions/phandle
    description: Phandle to the MT6351 audio codec.

required:
  - compatible
  - mediatek,platform
  - mediatek,audio-codec

additionalProperties: false

examples:
  - |
    sound {
        compatible = "mediatek,mt6797-mt6351-sound";
        model = "mt6797-mt6351";
        audio-widgets = "Headphone", "Headphone Jack";
        audio-routing =
            "Headphone Jack", "HPL",
            "Headphone Jack", "HPR";
        mediatek,platform = <&afe>;
        mediatek,audio-codec = <&mt6351_codec>;
    };

...
```

## Documentation/devicetree/bindings/sound/mt6351.txt
```
Mediatek MT6351 Audio Codec

The communication between MT6351 and SoC is through Mediatek PMIC wrapper.
For more detail, please visit Mediatek PMIC wrapper documentation.

Must be a child node of PMIC wrapper.

Required properties:

- compatible : "mediatek,mt6351-sound".
- vusb33-supply : Regulator supplying the shared 3.3 V rail.
- va18-supply : Regulator supplying the 1.8 V analog rail.

Optional properties:

- mediatek,jack-detection : Enable the internal active-low PMIC EINT detector
  when the machine driver attaches an ALSA jack. This supports ACC detection
  with 2.7 V microphone bias; AP GPIO detection and external contact switches
  are not described by this property. The detector reports headphones and a
  headset microphone. Button ADC decoding is not yet supported.
- mediatek,accdet-pwm-settings : Required with mediatek,jack-detection. Seven
  integers: PWM width, PWM threshold, falling-delay enable, rising delay,
  AB=0 debounce, AB=1 debounce and AB=3 debounce. Width and threshold are in
  hardware ticks (1..65535), with threshold <= width; falling-delay enable is
  0 or 1, rising delay is 0..32767, and the debounce values are 1..65535.

Example:

mt6351_snd {
	compatible = "mediatek,mt6351-sound";
	vusb33-supply = <&mt6351_vusb33_reg>;
	va18-supply = <&mt6351_va18_reg>;
};
```

## Documentation/devicetree/bindings/sound/mt6797-mt6351.txt
```
MT6797 with MT6351 CODEC

Required properties:
- compatible: "mediatek,mt6797-mt6351-sound", or
  "planet,gemini-mt6797-mt6351" for the Gemini PDA audio gates
- mediatek,platform: the phandle of MT6797 ASoC platform
- mediatek,audio-codec: the phandles of MT6351 codec

Required properties for "planet,gemini-mt6797-mt6351":
- microphone-enable-gpios: active-high GPIO enabling the board's microphone
  capture path. This is the legacy headphone_en signal (GPIO234), not the
  headphone contact-selection signal or either speaker amplifier enable.
  It is held low while the card is idle and managed with the capture PGAs.

- speaker-enable-gpios: two active-high, non-sleeping SoC GPIOs controlling
  the external speaker amplifiers, in vendor EXTAMP/EXTAMP2 order (GPIO243,
  GPIO244). The amplifiers use mode 3 with three 2 us low/high pulses. They
  are enabled after the headphone buffers and disabled before those buffers.
  Both pins are held low at card initialization and when Speaker is disabled.

Example:

	sound {
		compatible = "mediatek,mt6797-mt6351-sound";
		mediatek,audio-codec = <&mt6351_snd>;
		mediatek,platform = <&afe>;
	};
```

## Documentation/devicetree/bindings/usb/onsemi,fusb301.yaml
```yaml
# SPDX-License-Identifier: (GPL-2.0-only OR BSD-2-Clause)
%YAML 1.2
---
$id: http://devicetree.org/schemas/usb/onsemi,fusb301.yaml#
$schema: http://devicetree.org/meta-schemas/core.yaml#

title: onsemi FUSB301 autonomous USB Type-C controller

description: |
  The onsemi FUSB301 and FUSB301A are autonomous USB Type-C 1.1
  controllers. They detect source/sink, dual-role, accessory, VBUS, BC
  current, and CC orientation, and report events through an active-low
  interrupt. They do not implement USB Power Delivery or TCPCI.

maintainers:
  - Julien Etienne <julien.etienne@gmail.com>

properties:
  compatible:
    enum:
      - onsemi,fusb301
      - onsemi,fusb301a

  reg:
    maxItems: 1

  interrupts:
    maxItems: 1

  vbus-supply:
    description:
      Regulator supplying connector VBUS when the port is acting as a source.

  connector:
    type: object
    $ref: ../connector/usb-connector.yaml#
    unevaluatedProperties: false
    description:
      The managed USB Type-C connector. FUSB301 does not support Power
      Delivery, so the connector must set pd-disable.
    properties:
      compatible:
        const: usb-c-connector
    required:
      - pd-disable

required:
  - compatible
  - reg
  - interrupts
  - connector

additionalProperties: false

examples:
  - |
    #include <dt-bindings/interrupt-controller/irq.h>

    i2c {
      #address-cells = <1>;
      #size-cells = <0>;

      typec@25 {
        compatible = "onsemi,fusb301";
        reg = <0x25>;
        interrupt-parent = <&gpio0>;
        interrupts = <4 IRQ_TYPE_LEVEL_LOW>;

        connector {
          compatible = "usb-c-connector";
          label = "USB-C";
          power-role = "dual";
          data-role = "dual";
          typec-power-opmode = "default";
          pd-disable;
        };
      };
    };
```
