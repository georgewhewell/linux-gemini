## drivers/media/platform/mediatek/camsv/Kconfig
```kconfig
# SPDX-License-Identifier: GPL-2.0-only

config VIDEO_MTK_MT6797_CAMSV_CORE
	tristate

config VIDEO_MTK_MT6797_CAMSV
	tristate "MediaTek MT6797 CAMSV capture engine"
	depends on ARCH_MEDIATEK || COMPILE_TEST
	depends on VIDEO_DEV
	depends on OF
	select MEDIA_CONTROLLER
	select V4L2_ASYNC
	select V4L2_FWNODE
	select VIDEOBUF2_DMA_CONTIG
	select VIDEO_MTK_MT6797_CAMSV_CORE
	help
	  Build the V4L2 capture driver for the first MT6797 CAMSV engine.
	  It exposes the source-recovered CAMSV0 RAW10 packed path through a
	  standard media-controller graph and videobuf2 DMA queue. Other engines,
	  formats and dimensions remain unavailable until independently proven.
	  This does not provide an ISP or establish a particular board topology.

config VIDEO_MTK_MT6797_CAMSV_KUNIT_TEST
	tristate "KUnit tests for the MT6797 CAMSV core" if !KUNIT_ALL_TESTS
	depends on KUNIT
	select VIDEO_MTK_MT6797_CAMSV_CORE
	default KUNIT_ALL_TESTS
	help
	  Test MT6797 CAMSV format validation and register-plan construction.
	  The tests verify the one supported packed RAW10 format, exact register
	  values, and fail-closed rejection of incomplete plans. They do not
	  access hardware and can run on any KUnit-capable architecture.
```

## drivers/media/platform/mediatek/seninf/Kconfig
```kconfig
# SPDX-License-Identifier: GPL-2.0-only

config VIDEO_MTK_MT6797_SENINF_CORE
	tristate

config VIDEO_MTK_MT6797_SENINF
	tristate "MediaTek MT6797 SENINF receiver core"
	depends on ARCH_MEDIATEK || COMPILE_TEST
	depends on VIDEO_DEV
	depends on OF
	depends on NVMEM
	select MEDIA_CONTROLLER
	select V4L2_ASYNC
	select V4L2_FWNODE
	select VIDEO_MTK_MT6797_SENINF_CORE
	help
	  Build the V4L2 bridge for the MT6797 sensor interface and CSI-2
	  receiver. The driver supports the source-recovered NCSI2 route at
	  2592x1944, with two data lanes and a 440 MHz link. Board topology,
	  unestablished routes and other modes fail closed.

config VIDEO_MTK_MT6797_SENINF_KUNIT_TEST
	tristate "KUnit tests for the MT6797 SENINF core" if !KUNIT_ALL_TESTS
	depends on KUNIT
	select VIDEO_MTK_MT6797_SENINF_CORE
	default KUNIT_ALL_TESTS
	help
	  Test MT6797 SENINF resource, endpoint, format and register-plan
	  helpers. The tests verify programming and rollback with fake register
	  banks. They never touch hardware and can run on any KUnit-capable
	  architecture.
```

## drivers/media/platform/mediatek/vcodec/Kconfig
```kconfig
# SPDX-License-Identifier: GPL-2.0-only
config VIDEO_MEDIATEK_VCODEC_SCP
	bool

config VIDEO_MEDIATEK_VCODEC_VPU
	bool

config VIDEO_MEDIATEK_VCODEC
	tristate "Mediatek Video Codec driver"
	depends on V4L_MEM2MEM_DRIVERS
	depends on MTK_IOMMU || COMPILE_TEST
	depends on VIDEO_DEV
	depends on ARCH_MEDIATEK || COMPILE_TEST
	depends on VIDEO_MEDIATEK_VPU || MTK_SCP
	# The two following lines ensure we have the same state ("m" or "y") as
	# our dependencies, to avoid missing symbols during link.
	depends on VIDEO_MEDIATEK_VPU || !VIDEO_MEDIATEK_VPU
	depends on MTK_SCP || !MTK_SCP
	depends on MTK_SMI || (COMPILE_TEST && MTK_SMI=n)
	select VIDEOBUF2_DMA_CONTIG
	select V4L2_MEM2MEM_DEV
	select VIDEO_MEDIATEK_VCODEC_VPU if VIDEO_MEDIATEK_VPU
	select VIDEO_MEDIATEK_VCODEC_SCP if MTK_SCP
	select V4L2_H264
	select V4L2_VP9
	select MEDIA_CONTROLLER
	help
	  Mediatek video codec driver provides HW capability to
	  encode and decode in a range of video formats on MT8173
	  and MT8183.

	  Note that support for MT8173 requires VIDEO_MEDIATEK_VPU to
	  also be selected. Support for MT8183 depends on MTK_SCP.

	  To compile this driver as modules, choose M here: the
	  modules will be called mtk-vcodec-dec and mtk-vcodec-enc.

config VIDEO_MEDIATEK_VCODEC_KUNIT_TEST
	tristate "KUnit tests for MediaTek video codec register translation" if !KUNIT_ALL_TESTS
	depends on KUNIT
	default KUNIT_ALL_TESTS
	help
	  Test pure register translation and request validation helpers used by
	  firmwareless MediaTek video codec backends. These tests do not access
	  codec hardware and are safe to run on any KUnit-supported architecture.

	  If unsure, say N.
```

## drivers/net/wireless/mediatek/mt6797/Kconfig
```kconfig
# SPDX-License-Identifier: GPL-2.0-only
config MT6797_WIFI_AHB_HIF
	tristate "MediaTek MT6797 Wi-Fi AHB transport library"
	depends on ARCH_MEDIATEK || COMPILE_TEST
	depends on HAS_IOMEM
	help
	  Build the low-level, PIO-only transport library for the SDIO-like
	  Wi-Fi host interface found in the MT6797 connectivity subsystem.

	  This library has no bus driver and no device registration.  Enabling
	  it alone does not bind a device or access hardware.

	  If unsure, say N.

config MT6797_WIFI_AHB_HIF_KUNIT_TEST
	bool "KUnit tests for the MT6797 Wi-Fi AHB transport" if !KUNIT_ALL_TESTS
	depends on KUNIT
	depends on MT6797_WIFI_AHB_HIF
	default KUNIT_ALL_TESTS
	help
	  Run tests for command encoding and bounded transfer planning in the
	  MT6797 Wi-Fi AHB transport library.  The tests do not require MT6797
	  hardware and do not perform MMIO accesses.

	  If unsure, say N.

config MTK_MT6797_WIFI
	tristate "MediaTek MT6797 integrated GEN3 WLAN endpoint"
	depends on OF && MTK_MT6797_CONSYS_INVENTORY
	select CRYPTO_SHA256
	select FW_LOADER
	select MT6797_WIFI_AHB_HIF
	help
	  Build the platform endpoint for the MT6797 integrated GEN3 WLAN host
	  interface. The driver acquires the aggregate's exclusive Wi-Fi lease,
	  downloads the exact SHA-256-pinned divided firmware over the bounded
	  AHB PIO and temporary shared-EMI paths, waits for firmware READY, then
	  performs one bounded NIC capability command/event exchange and sends the
	  post-capability basic configuration with all checksum offload disabled.

	  IRQ283 is requested once with IRQF_NO_AUTOEN. After configuration, the
	  driver establishes persistent ownership of the ordinary HIF interrupt
	  format and gates. Runtime interrupts use read-clear acknowledgment, TX
	  release accounting, and a bounded ordinary-mode RX pump. Valid firmware
	  events and frame classes are decoded and counted but not yet delivered to
	  a radio consumer. Any malformed, overflowing, timed-out, or failed pump is
	  fenced and stopped asynchronously. No wiphy or network device is
	  registered. The Device Tree node is disabled by default, so enabling this
	  option alone performs no hardware access.

config MTK_MT6797_WIFI_KUNIT_TEST
	bool "KUnit tests for the MT6797 WLAN firmware boundary" if !KUNIT_ALL_TESTS
	depends on KUNIT
	depends on MTK_MT6797_WIFI=y
	default KUNIT_ALL_TESTS
	help
	  Exercise exact divided-header parsing, boot and NIC-capability transaction
	  ordering, bounded runtime command/event and RX/TX descriptor codecs, basic
	  configuration and persistent HIF lifecycle, rollback, and terminal fencing
	  plus strict RX group-3 and beacon/probe metadata parsing using memory-only
	  fixtures. No firmware is requested and no MMIO,
	  interrupt, regulator, CONSYS, or Wi-Fi hardware is accessed.
	  It also checks copied, generation-scoped selection of an explicitly named
	  BSSID and SSID from validated beacon/probe metadata, including refresh and
	  expiry behavior.
	  The suite also covers the pure caller-serialized AIS station and
	  WLAN-table resource ledger, including atomic allocation rollback and
	  stale-handle rejection, plus caller-driven AIS transaction ordering,
	  timeout arbitration, reverse teardown, and terminal fencing.
```

## drivers/net/wwan/mediatek/Kconfig
```kconfig
# SPDX-License-Identifier: GPL-2.0-only

config MTK_CCCI_COMMON
	bool
	help
	  Internal wire-format and runtime-negotiation helpers for MediaTek CCCI
	  modems. The helpers perform no I/O and own no modem hardware.

config MTK_MT6797_CCCI
	bool "MediaTek MT6797 integrated modem CCCI transport"
	depends on ARM64 && OF
	depends on WWAN=y
	depends on MTK_MT6797_MD1_COLD_OWNER=y
	depends on MTK_MT6797_MD1_LK_HANDOFF_PROBE=y
	select MTK_CCCI_COMMON
	select MTK_MT6797_MD1_CLDMA_CORE
	select MTK_MT6797_MD1_HS_CORE
	help
	  Own the AP-side CLDMA rings and CCCI handshake for the integrated MT6797
	  MD1 modem. The driver requires an LK-attested shared-memory layout and a
	  positive post-vector activity token from the separate lifecycle owner.
	  It finalizes the vendor stage-two region-13 protection before the HS1
	  runtime reply and latches duplicate/invalid handshake, WDT and bounded
	  handshake-timeout failures until platform reset. After HS2 it exposes the
	  UART2 control channel as a standard WWAN AT port and CCMNI contexts as WWAN
	  raw-IP links. It remains additionally gated by a read-only module parameter.

config MTK_CCCI_KUNIT_TEST
	bool "KUnit tests for MediaTek CCCI helpers"
	depends on KUNIT=y
	select MTK_CCCI_COMMON
	help
	  Exercise CCCI framing, MT6797 CCMNI channel mapping and bounded HS1 v2
	  runtime-feature negotiation without modem hardware. The tests reject
	  malformed feature queries and modem requirements which this driver
	  cannot safely satisfy.
```

## drivers/net/wwan/mediatek/mt6797/Kconfig
```kconfig
# SPDX-License-Identifier: GPL-2.0-only

config MTK_MT6797_MODEM_PROTOCOL
	bool "MediaTek MT6797 modem protocol helpers"
	depends on ARCH_MEDIATEK || COMPILE_TEST
	help
	  Build helpers for the fixed CCCI header, CLDMA descriptor address
	  formats, and ordered boot-control handshake used by the integrated
	  MT6797 modem.  This option does not register a device, access hardware,
	  or start modem firmware.

	  If unsure, say N.

config MTK_MT6797_MD1
	tristate "MediaTek MT6797 MD1 ownership core"
	depends on ARCH_MEDIATEK || COMPILE_TEST
	depends on COMMON_CLK && OF && RESET_CONTROLLER
	select MFD_SYSCON
	select MTK_MT6797_MODEM_PROTOCOL
	help
	  Claim the standard clock, reset, interrupt, MMIO, and reserved-memory
	  resources of the integrated MT6797 MD1 modem.  If the bootloader left
	  MD1 powered and CLDMA/CCIF strictly quiescent, the driver resets the AP
	  CLDMA block and creates a private control-RX ring to receive CCCI HS1.
	  It validates and refills the completed descriptor, then stops at that
	  boundary.  The evidenced UART2 WWAN control port remains gated until
	  HS2 and separately owned queue-1 RX/TX paths exist.

	  This driver does not load or start modem firmware, change modem power
	  state, send runtime data, or access radio hardware.  The DT node is
	  disabled by default.  If unsure, say N.

config MTK_MT6797_MD1_KUNIT_TEST
	bool "KUnit tests for MT6797 MD1 observation" if !KUNIT_ALL_TESTS
	depends on KUNIT
	depends on MTK_MT6797_MD1=y
	default KUNIT_ALL_TESTS
	help
	  Validate fail-closed classification of the two read-only SPM
	  power-status bits and inherited CLDMA/CCIF configuration, plus exact
	  construction and ownership checks for the control receive ring.  The
	  tests cover disagreement, pending CCIF work, foreign rings, invalid DMA
	  addresses, corrupted links, malformed descriptors, refill, CCCI receive
	  sequencing, and the fail-closed UART2 port gate.  They are hardware
	  independent; no modem resources are acquired or accessed.

config MTK_MT6797_MODEM_PROTOCOL_KUNIT_TEST
	bool "KUnit tests for MT6797 modem protocol helpers" if !KUNIT_ALL_TESTS
	depends on KUNIT
	depends on MTK_MT6797_MODEM_PROTOCOL=y
	default KUNIT_ALL_TESTS
	help
	  Run tests for the fixed-width MT6797 CCCI header and for packing
	  36-bit CLDMA addresses into descriptors.  The tests cover exact
	  little-endian representations, round trips, range checking, boot
	  handshake ordering, exception fencing, and preservation of unrelated
	  descriptor bits.
```

## drivers/pmdomain/mediatek/Kconfig
```kconfig
# SPDX-License-Identifier: GPL-2.0-only

menu "MediaTek PM Domains"
	depends on ARCH_MEDIATEK || COMPILE_TEST

config MTK_SCPSYS
	bool "MediaTek SCPSYS Support"
	default ARCH_MEDIATEK
	depends on OF
	select REGMAP
	select MTK_INFRACFG
	select PM_GENERIC_DOMAINS if PM
	help
	  Say yes here to add support for the MediaTek SCPSYS power domain
	  driver.

config MTK_SCPSYS_KUNIT_TEST
	bool "KUnit tests for MediaTek SCPSYS helpers"
	depends on KUNIT=y
	depends on MTK_SCPSYS=y
	default KUNIT_ALL_TESTS
	help
	  Test hardware-independent MediaTek SCPSYS sequencing helpers. The
	  tests validate shared bus-protection release admission from synthetic
	  primary and secondary power-status values. No registers are accessed
	  and no power-domain state is changed by these tests.

config MTK_SCPSYS_PM_DOMAINS
	bool "MediaTek SCPSYS generic power domain"
	default ARCH_MEDIATEK
	depends on PM
	select PM_GENERIC_DOMAINS
	select REGMAP
	help
	  Say y here to enable power domain support.
	  In order to meet high performance and low power requirements, the System
	  Control Processor System (SCPSYS) has several power management related
	  tasks in the system.

config MTK_MFG_PM_DOMAIN
	bool "MediaTek MFlexGraphics power domain"
	default ARCH_MEDIATEK
	depends on PM
	depends on OF
	depends on COMMON_CLK
	select MAILBOX
	select PM_GENERIC_DOMAINS
	imply MTK_GPUEB_MBOX
	help
	  Say y or m here to enable the power domains driver for MediaTek
	  MFlexGraphics. This driver allows for power and frequency control of
	  GPUs on MediaTek SoCs such as the MT8196 or MT6991.

	  This driver is required for the Mali GPU to work at all on MT8196 and
	  MT6991.

config AIROHA_CPU_PM_DOMAIN
	tristate "Airoha CPU power domain"
	default ARCH_AIROHA
	depends on HAVE_ARM_SMCCC
	depends on PM
	select PM_GENERIC_DOMAINS
	help
	  Say y here to enable CPU power domain support for Airoha SoC.

	  CPU frequency and power is controlled by ATF with SMC command to
	  set performance states.

endmenu
```
