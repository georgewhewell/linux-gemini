// SPDX-License-Identifier: (GPL-2.0-only OR MIT)
/*
 * Planet Computers Gemini PDA Cortex-A72 PSCI CPU_ON gate.
 *
 * Apply after mt6797-gemini-a72-resource-preflight.dtso in a volatile FIT.
 * maxcpus=8 prevents CPU8 from reaching the custom PSCI admission owner during
 * SMP boot, before the platform resource gate is installed.  This overlay
 * admits only CPU8 but leaves it offline for read-only qualification.  CPU9
 * stays closed by the custom operation, and no OPP, OCP, or frequency-changing
 * path is exposed.
 */

/dts-v1/;
/plugin/;

/ {
	compatible = "planet,gemini-pda", "mediatek,mt6797";
};

&{/chosen} {
	bootargs = "maxcpus=8 regulator_ignore_unused";
};

&cpu8 {
	enable-method = "mediatek,mt6797-psci";
	status = "okay";
};

&cpu9 {
	enable-method = "mediatek,mt6797-psci";
	status = "disabled";
};
