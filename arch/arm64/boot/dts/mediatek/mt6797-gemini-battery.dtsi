// SPDX-License-Identifier: GPL-2.0-only
/*
 * Copyright (C) 2015 MediaTek Inc.
 *
 * Original Gemini battery ZCV profiles from vendor revision 51e705e4.
 * Source: mt6797/include/mach/mt_battery_meter_table.h, active HAFG_20
 * header initialization (not the generic vendor device tree).
 * Generated by tools/gemini/import-gemini-battery-profile.py.
 * Convert mV to uV and depth of discharge to remaining percent;
 * remove only identical consecutive points. T0 means -10 C; the
 * vendor TEMPERATURE_T0 value 110 is a selector, not a temperature.
 * These profiles do not specify measured capacity, aging, charger
 * limits or installed-pack calibration. Qmax is not design capacity.
 */

/ {
	gemini_battery: battery {
		compatible = "simple-battery";
		ocv-capacity-celsius = <(-10) 0 25 50>;

		/* -10 degrees Celsius. */
		ocv-capacity-table-0 =
			<4372000 100>,
			<4349000 99>,
			<4328000 98>,
			<4309000 97>,
			<4290000 96>,
			<4274000 95>,
			<4258000 94>,
			<4243000 92>,
			<4229000 91>,
			<4216000 90>,
			<4203000 89>,
			<4190000 88>,
			<4178000 87>,
			<4166000 86>,
			<4154000 85>,
			<4142000 84>,
			<4130000 83>,
			<4119000 82>,
			<4108000 81>,
			<4099000 80>,
			<4088000 79>,
			<4078000 77>,
			<4065000 76>,
			<4050000 75>,
			<4033000 74>,
			<4015000 73>,
			<3998000 72>,
			<3984000 71>,
			<3971000 70>,
			<3958000 69>,
			<3948000 68>,
			<3939000 67>,
			<3930000 66>,
			<3922000 65>,
			<3914000 64>,
			<3907000 62>,
			<3899000 61>,
			<3892000 60>,
			<3885000 59>,
			<3878000 58>,
			<3871000 57>,
			<3864000 56>,
			<3858000 55>,
			<3852000 54>,
			<3846000 53>,
			<3840000 52>,
			<3834000 51>,
			<3829000 50>,
			<3824000 49>,
			<3819000 47>,
			<3815000 46>,
			<3810000 45>,
			<3807000 44>,
			<3803000 43>,
			<3800000 42>,
			<3797000 41>,
			<3794000 40>,
			<3792000 39>,
			<3789000 38>,
			<3787000 37>,
			<3785000 36>,
			<3783000 35>,
			<3780000 34>,
			<3778000 32>,
			<3776000 31>,
			<3774000 30>,
			<3771000 29>,
			<3769000 28>,
			<3766000 27>,
			<3763000 26>,
			<3760000 25>,
			<3757000 24>,
			<3754000 23>,
			<3750000 22>,
			<3746000 21>,
			<3742000 20>,
			<3738000 18>,
			<3733000 17>,
			<3728000 16>,
			<3723000 15>,
			<3717000 14>,
			<3711000 13>,
			<3705000 12>,
			<3701000 11>,
			<3696000 10>,
			<3691000 9>,
			<3686000 8>,
			<3680000 7>,
			<3671000 6>,
			<3655000 5>,
			<3629000 3>,
			<3588000 2>,
			<3529000 1>,
			<3400000 0>;

		/* 0 degrees Celsius. */
		ocv-capacity-table-1 =
			<4370000 100>,
			<4350000 99>,
			<4331000 98>,
			<4313000 97>,
			<4296000 95>,
			<4280000 94>,
			<4265000 93>,
			<4250000 92>,
			<4237000 91>,
			<4223000 90>,
			<4210000 88>,
			<4197000 87>,
			<4184000 86>,
			<4171000 85>,
			<4158000 84>,
			<4146000 83>,
			<4133000 81>,
			<4120000 80>,
			<4109000 79>,
			<4098000 78>,
			<4088000 77>,
			<4079000 76>,
			<4068000 75>,
			<4054000 73>,
			<4035000 72>,
			<4015000 71>,
			<3997000 70>,
			<3980000 69>,
			<3967000 68>,
			<3955000 66>,
			<3945000 65>,
			<3936000 64>,
			<3927000 63>,
			<3918000 62>,
			<3910000 61>,
			<3901000 60>,
			<3893000 58>,
			<3884000 57>,
			<3876000 56>,
			<3868000 55>,
			<3861000 54>,
			<3854000 53>,
			<3847000 51>,
			<3841000 50>,
			<3835000 49>,
			<3830000 48>,
			<3825000 47>,
			<3819000 46>,
			<3814000 44>,
			<3810000 43>,
			<3806000 42>,
			<3801000 41>,
			<3798000 40>,
			<3794000 39>,
			<3791000 38>,
			<3789000 36>,
			<3786000 35>,
			<3784000 34>,
			<3782000 33>,
			<3780000 32>,
			<3778000 31>,
			<3776000 29>,
			<3773000 28>,
			<3771000 27>,
			<3768000 26>,
			<3765000 25>,
			<3762000 24>,
			<3758000 22>,
			<3754000 21>,
			<3750000 20>,
			<3745000 19>,
			<3739000 18>,
			<3734000 17>,
			<3727000 16>,
			<3721000 14>,
			<3715000 13>,
			<3708000 12>,
			<3701000 11>,
			<3695000 10>,
			<3690000 9>,
			<3685000 7>,
			<3678000 6>,
			<3667000 5>,
			<3647000 4>,
			<3610000 3>,
			<3553000 2>,
			<3400000 0>;

		/* 25 degrees Celsius. */
		ocv-capacity-table-2 =
			<4357000 100>,
			<4344000 99>,
			<4330000 98>,
			<4316000 96>,
			<4301000 95>,
			<4287000 94>,
			<4274000 93>,
			<4261000 92>,
			<4248000 91>,
			<4235000 89>,
			<4222000 88>,
			<4209000 87>,
			<4196000 86>,
			<4183000 85>,
			<4170000 84>,
			<4157000 82>,
			<4144000 81>,
			<4132000 80>,
			<4119000 79>,
			<4107000 78>,
			<4094000 77>,
			<4082000 75>,
			<4071000 74>,
			<4064000 73>,
			<4057000 72>,
			<4043000 71>,
			<4023000 70>,
			<4004000 68>,
			<3989000 67>,
			<3978000 66>,
			<3970000 65>,
			<3964000 64>,
			<3960000 63>,
			<3952000 61>,
			<3941000 60>,
			<3927000 59>,
			<3913000 58>,
			<3900000 57>,
			<3888000 56>,
			<3879000 54>,
			<3870000 53>,
			<3863000 52>,
			<3856000 51>,
			<3849000 50>,
			<3843000 49>,
			<3837000 47>,
			<3832000 46>,
			<3826000 45>,
			<3821000 44>,
			<3816000 43>,
			<3812000 42>,
			<3807000 40>,
			<3803000 39>,
			<3800000 38>,
			<3795000 37>,
			<3792000 36>,
			<3789000 35>,
			<3785000 33>,
			<3782000 32>,
			<3779000 31>,
			<3776000 30>,
			<3772000 29>,
			<3767000 28>,
			<3764000 26>,
			<3760000 25>,
			<3756000 24>,
			<3751000 23>,
			<3747000 22>,
			<3743000 21>,
			<3739000 19>,
			<3734000 18>,
			<3728000 17>,
			<3721000 16>,
			<3715000 15>,
			<3709000 14>,
			<3700000 12>,
			<3691000 11>,
			<3688000 10>,
			<3687000 9>,
			<3686000 8>,
			<3684000 7>,
			<3681000 5>,
			<3669000 4>,
			<3628000 3>,
			<3568000 2>,
			<3483000 1>,
			<3400000 0>;

		/* 50 degrees Celsius. */
		ocv-capacity-table-3 =
			<4360000 100>,
			<4348000 99>,
			<4336000 98>,
			<4323000 96>,
			<4310000 95>,
			<4297000 94>,
			<4284000 93>,
			<4270000 92>,
			<4256000 91>,
			<4243000 89>,
			<4230000 88>,
			<4216000 87>,
			<4203000 86>,
			<4190000 85>,
			<4176000 83>,
			<4163000 82>,
			<4150000 81>,
			<4138000 80>,
			<4125000 79>,
			<4112000 77>,
			<4100000 76>,
			<4088000 75>,
			<4076000 74>,
			<4064000 73>,
			<4052000 72>,
			<4041000 70>,
			<4030000 69>,
			<4018000 68>,
			<4006000 67>,
			<3998000 66>,
			<3987000 64>,
			<3977000 63>,
			<3967000 62>,
			<3955000 61>,
			<3940000 60>,
			<3922000 59>,
			<3909000 57>,
			<3899000 56>,
			<3890000 55>,
			<3881000 54>,
			<3874000 53>,
			<3866000 51>,
			<3859000 50>,
			<3853000 49>,
			<3846000 48>,
			<3840000 47>,
			<3834000 45>,
			<3829000 44>,
			<3823000 43>,
			<3818000 42>,
			<3813000 41>,
			<3808000 40>,
			<3804000 38>,
			<3800000 37>,
			<3796000 36>,
			<3792000 35>,
			<3788000 34>,
			<3785000 32>,
			<3781000 31>,
			<3775000 30>,
			<3767000 29>,
			<3758000 28>,
			<3752000 27>,
			<3747000 25>,
			<3742000 24>,
			<3737000 23>,
			<3732000 22>,
			<3727000 21>,
			<3723000 19>,
			<3719000 18>,
			<3713000 17>,
			<3706000 16>,
			<3700000 15>,
			<3693000 14>,
			<3684000 12>,
			<3677000 11>,
			<3676000 10>,
			<3675000 9>,
			<3674000 8>,
			<3672000 6>,
			<3668000 5>,
			<3649000 4>,
			<3604000 3>,
			<3542000 2>,
			<3400000 0>;
	};
};

&mt6351fgadc {
	/* Header Qmax is an estimator input, not charge-full-design. */
	mediatek,capacity-model =
		<(-10) 4336000>,
		<0 4312000>,
		<25 4268000>,
		<50 4211000>;

	/* -10 degrees Celsius: uV, uOhm. */
	mediatek,resistance-table-0 =
		<4372000 1426000>,
		<4349000 1426000>,
		<4328000 1434000>,
		<4309000 1419000>,
		<4290000 1402000>,
		<4274000 1380000>,
		<4258000 1358000>,
		<4243000 1320000>,
		<4229000 1320000>,
		<4216000 1299000>,
		<4203000 1279000>,
		<4190000 1261000>,
		<4178000 1244000>,
		<4166000 1233000>,
		<4154000 1219000>,
		<4142000 1202000>,
		<4130000 1190000>,
		<4119000 1179000>,
		<4108000 1168000>,
		<4099000 1160000>,
		<4088000 1152000>,
		<4078000 1140000>,
		<4065000 1128000>,
		<4050000 1106000>,
		<4033000 1089000>,
		<4015000 1064000>,
		<3998000 1045000>,
		<3984000 1030000>,
		<3971000 1017000>,
		<3958000 1009000>,
		<3948000 1002000>,
		<3939000 996000>,
		<3930000 990000>,
		<3922000 987000>,
		<3914000 986000>,
		<3907000 979000>,
		<3899000 977000>,
		<3892000 972000>,
		<3885000 968000>,
		<3878000 964000>,
		<3871000 961000>,
		<3864000 957000>,
		<3858000 955000>,
		<3852000 951000>,
		<3846000 950000>,
		<3840000 947000>,
		<3834000 946000>,
		<3829000 947000>,
		<3824000 948000>,
		<3819000 947000>,
		<3815000 947000>,
		<3810000 947000>,
		<3807000 951000>,
		<3803000 955000>,
		<3800000 960000>,
		<3797000 966000>,
		<3794000 974000>,
		<3792000 982000>,
		<3789000 988000>,
		<3787000 1000000>,
		<3785000 1006000>,
		<3783000 1016000>,
		<3780000 1023000>,
		<3778000 1032000>,
		<3776000 1041000>,
		<3774000 1050000>,
		<3771000 1064000>,
		<3769000 1070000>,
		<3766000 1079000>,
		<3763000 1092000>,
		<3760000 1106000>,
		<3757000 1116000>,
		<3754000 1129000>,
		<3750000 1143000>,
		<3746000 1159000>,
		<3742000 1175000>,
		<3738000 1191000>,
		<3733000 1209000>,
		<3728000 1230000>,
		<3723000 1251000>,
		<3717000 1273000>,
		<3711000 1298000>,
		<3705000 1326000>,
		<3701000 1361000>,
		<3696000 1390000>,
		<3691000 1420000>,
		<3686000 1460000>,
		<3680000 1500000>,
		<3671000 1544000>,
		<3655000 1582000>,
		<3629000 1628000>,
		<3588000 1671000>,
		<3529000 1737000>,
		<3400000 1839000>;

	/* 0 degrees Celsius: uV, uOhm. */
	mediatek,resistance-table-1 =
		<4370000 797000>,
		<4350000 797000>,
		<4331000 801000>,
		<4313000 797000>,
		<4296000 790000>,
		<4280000 782000>,
		<4265000 775000>,
		<4250000 768000>,
		<4237000 761000>,
		<4223000 753000>,
		<4210000 745000>,
		<4197000 738000>,
		<4184000 733000>,
		<4171000 727000>,
		<4158000 721000>,
		<4146000 715000>,
		<4133000 710000>,
		<4120000 703000>,
		<4109000 698000>,
		<4098000 697000>,
		<4088000 696000>,
		<4079000 696000>,
		<4068000 692000>,
		<4054000 682000>,
		<4035000 665000>,
		<4015000 645000>,
		<3997000 629000>,
		<3980000 616000>,
		<3967000 607000>,
		<3955000 600000>,
		<3945000 593000>,
		<3936000 589000>,
		<3927000 583000>,
		<3918000 578000>,
		<3910000 572000>,
		<3901000 565000>,
		<3893000 558000>,
		<3884000 552000>,
		<3876000 549000>,
		<3868000 545000>,
		<3861000 542000>,
		<3854000 540000>,
		<3847000 539000>,
		<3841000 537000>,
		<3835000 536000>,
		<3830000 535000>,
		<3825000 535000>,
		<3819000 536000>,
		<3814000 536000>,
		<3810000 537000>,
		<3806000 539000>,
		<3801000 540000>,
		<3798000 541000>,
		<3794000 545000>,
		<3791000 549000>,
		<3789000 555000>,
		<3786000 561000>,
		<3784000 567000>,
		<3782000 576000>,
		<3780000 582000>,
		<3778000 592000>,
		<3776000 600000>,
		<3773000 608000>,
		<3771000 617000>,
		<3768000 628000>,
		<3765000 637000>,
		<3762000 647000>,
		<3758000 658000>,
		<3754000 668000>,
		<3750000 681000>,
		<3745000 694000>,
		<3739000 710000>,
		<3734000 727000>,
		<3727000 744000>,
		<3721000 765000>,
		<3715000 789000>,
		<3708000 817000>,
		<3701000 851000>,
		<3695000 890000>,
		<3690000 938000>,
		<3685000 994000>,
		<3678000 1058000>,
		<3667000 1130000>,
		<3647000 1199000>,
		<3610000 1261000>,
		<3553000 1329000>,
		<3400000 1433000>;

	/* 25 degrees Celsius: uV, uOhm. */
	mediatek,resistance-table-2 =
		<4357000 127000>,
		<4344000 127000>,
		<4330000 125000>,
		<4316000 125000>,
		<4301000 121000>,
		<4287000 119000>,
		<4274000 120000>,
		<4261000 117000>,
		<4248000 115000>,
		<4235000 113000>,
		<4222000 121000>,
		<4209000 121000>,
		<4196000 122000>,
		<4183000 118000>,
		<4170000 118000>,
		<4157000 120000>,
		<4144000 119000>,
		<4132000 118000>,
		<4119000 118000>,
		<4107000 120000>,
		<4094000 119000>,
		<4082000 121000>,
		<4071000 123000>,
		<4064000 126000>,
		<4057000 129000>,
		<4043000 125000>,
		<4023000 118000>,
		<4004000 116000>,
		<3989000 117000>,
		<3978000 120000>,
		<3970000 121000>,
		<3964000 127000>,
		<3960000 131000>,
		<3952000 131000>,
		<3941000 127000>,
		<3927000 119000>,
		<3913000 109000>,
		<3900000 100000>,
		<3888000 96000>,
		<3879000 91000>,
		<3870000 90000>,
		<3863000 89000>,
		<3856000 90000>,
		<3849000 90000>,
		<3843000 91000>,
		<3837000 90000>,
		<3832000 92000>,
		<3826000 91000>,
		<3821000 92000>,
		<3816000 91000>,
		<3812000 92000>,
		<3807000 93000>,
		<3803000 93000>,
		<3800000 94000>,
		<3795000 94000>,
		<3792000 92000>,
		<3789000 93000>,
		<3785000 94000>,
		<3782000 94000>,
		<3779000 94000>,
		<3776000 96000>,
		<3772000 95000>,
		<3767000 92000>,
		<3764000 90000>,
		<3760000 90000>,
		<3756000 90000>,
		<3751000 90000>,
		<3747000 90000>,
		<3743000 90000>,
		<3739000 90000>,
		<3734000 89000>,
		<3728000 89000>,
		<3721000 89000>,
		<3715000 94000>,
		<3709000 97000>,
		<3700000 98000>,
		<3691000 97000>,
		<3688000 97000>,
		<3687000 100000>,
		<3686000 103000>,
		<3684000 109000>,
		<3681000 117000>,
		<3669000 123000>,
		<3628000 124000>,
		<3568000 135000>,
		<3483000 151000>,
		<3400000 189000>;

	/* 50 degrees Celsius: uV, uOhm. */
	mediatek,resistance-table-3 =
		<4360000 49000>,
		<4348000 49000>,
		<4336000 49000>,
		<4323000 50000>,
		<4310000 49000>,
		<4297000 49000>,
		<4284000 50000>,
		<4270000 50000>,
		<4256000 49000>,
		<4243000 51000>,
		<4230000 50000>,
		<4216000 50000>,
		<4203000 51000>,
		<4190000 51000>,
		<4176000 51000>,
		<4163000 51000>,
		<4150000 51000>,
		<4138000 52000>,
		<4125000 52000>,
		<4112000 52000>,
		<4100000 53000>,
		<4088000 53000>,
		<4076000 54000>,
		<4064000 54000>,
		<4052000 55000>,
		<4041000 56000>,
		<4030000 58000>,
		<4018000 57000>,
		<4006000 60000>,
		<3998000 62000>,
		<3987000 63000>,
		<3977000 65000>,
		<3967000 67000>,
		<3955000 69000>,
		<3940000 64000>,
		<3922000 55000>,
		<3909000 52000>,
		<3899000 50000>,
		<3890000 49000>,
		<3881000 49000>,
		<3874000 49000>,
		<3866000 48000>,
		<3859000 49000>,
		<3853000 49000>,
		<3846000 49000>,
		<3840000 49000>,
		<3834000 50000>,
		<3829000 50000>,
		<3823000 50000>,
		<3818000 51000>,
		<3813000 51000>,
		<3808000 51000>,
		<3804000 53000>,
		<3800000 53000>,
		<3796000 54000>,
		<3792000 55000>,
		<3788000 55000>,
		<3785000 57000>,
		<3781000 59000>,
		<3775000 55000>,
		<3767000 51000>,
		<3758000 49000>,
		<3752000 50000>,
		<3747000 51000>,
		<3742000 51000>,
		<3737000 50000>,
		<3732000 51000>,
		<3727000 51000>,
		<3723000 51000>,
		<3719000 52000>,
		<3713000 52000>,
		<3706000 51000>,
		<3700000 51000>,
		<3693000 52000>,
		<3684000 51000>,
		<3677000 49000>,
		<3676000 51000>,
		<3675000 52000>,
		<3674000 55000>,
		<3672000 57000>,
		<3668000 60000>,
		<3649000 56000>,
		<3604000 57000>,
		<3542000 61000>,
		<3400000 70000>;
};
