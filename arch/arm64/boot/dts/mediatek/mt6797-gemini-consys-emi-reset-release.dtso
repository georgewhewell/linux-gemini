// SPDX-License-Identifier: GPL-2.0-only
/*
 * MT6797 CONSYS shared-EMI ownership plus one bounded reset-release probe.
 *
 * The provider must be loaded with its ownership parameter and the consumer
 * needs its identity, shared-EMI, and reset-release parameters.  It writes
 * the vendor MBIST/AFE prefix, holds reset released for the vendor 20 ms
 * delay while BGF remains unrequested, then reasserts reset and drops all
 * reversible power votes.  EMI and AFE configuration have no
 * vendor inverse; a failed reset assertion requires watchdog recovery.
 */

/dts-v1/;
/plugin/;

#include <dt-bindings/power/mt6797-power.h>

/ {
	fragment@0 {
		target = <&consys_emi_mpu>;

		__overlay__ {
			mediatek,experimental-shared-emi-ownership;
			status = "okay";
		};
	};

	fragment@1 {
		target = <&consys>;
		/* Describe the target's inherited root bus to dtc only. */
		#address-cells = <2>;
		#size-cells = <2>;

		__overlay__ {
			compatible = "mediatek,mt6797-consys-emi-reset-release";
			reg = <0 0x18070000 0 0x200>,
			      <0 0x10007000 0 0x100>,
			      <0 0x10000000 0 0x2000>,
			      <0 0x10006000 0 0x1000>,
			      <0 0x180b6000 0 0x100>;
			reg-names = "mcu", "ap-rgu", "topckgen", "spm", "afe";
			mediatek,conn-power-domain = <&scpsys MT6797_POWER_DOMAIN_CONN>;
			mediatek,infracfg = <&infrasys>;
			mediatek,spm = <&scpsys>;
			mediatek,emi-mpu = <&consys_emi_mpu>;
			status = "okay";
		};
	};
};
