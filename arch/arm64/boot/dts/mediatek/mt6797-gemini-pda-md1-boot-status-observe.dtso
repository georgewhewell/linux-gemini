// SPDX-License-Identifier: GPL-2.0-only
/*
 * One-shot, read-only MT6797 MD1 boot-status observation.
 *
 * This overlay is inert unless explicitly loaded and then changed to okay by
 * the reviewed image builder. Its driver also refuses to probe unless
 * mt6797_md1_boot_status_observe.enable_experimental_boot_status=1 is set at
 * boot. It describes only the two AP-visible status words used by the vendor
 * CCCI report path (0x10201300 and 0x10201304), followed only by the vendor
 * diagnostic BUSY/ACK reads of AP/MD CCIF and fixed read-only SPM/infracfg
 * ownership words. It adds no CLDMA, IRQ, DMA, memory-region, clock,
 * power-domain vote, reset, firmware, SIM, or radio resource.
 */

/dts-v1/;
/plugin/;

/ {
	fragment@0 {
		target-path = "/";
		/* Describe the target's inherited root bus to dtc only. */
		#address-cells = <2>;
		#size-cells = <2>;

		__overlay__ {
			/* These match the root bus and make the child reg unambiguous. */
			#address-cells = <2>;
			#size-cells = <2>;

			md1_boot_status_observe: modem-boot-status@10201300 {
				compatible = "mediatek,mt6797-md1-boot-status-observe";
				reg = <0 0x10201300 0 0x8>,
				      <0 0x10209000 0 0x1000>,
				      <0 0x1020a000 0 0x1000>;
				reg-names = "md1-boot-status", "ap-ccif", "md-ccif";
				mediatek,spm = <&scpsys>;
				mediatek,infracfg = <&infrasys>;
				mediatek,experimental-md1-boot-status;
				status = "disabled";
			};
		};
	};
};
