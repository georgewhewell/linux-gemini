// SPDX-License-Identifier: (GPL-2.0-only OR MIT)
/*
 * Planet Computers Gemini PDA BQ2589x charger observation candidate.
 *
 * The board DWS routes SW_CHARGER at 0x6b to I2C_CHANNEL_0, whose GPIO37/38
 * pins and 0x11007000 controller match the mainline i2c0 description. A live
 * vendor capture independently found the bound charger at i2c-0/0x6b.
 *
 * The exact BQ2589x variant and CHR_STAT interrupt route remain unknown. This
 * opt-in overlay therefore enables only a no-write, no-IRQ status observer;
 * it supplies no charge limits, battery consumer, regulator, or OTG control.
 */

/dts-v1/;
/plugin/;

/ {
	compatible = "planet,gemini-pda", "mediatek,mt6797";
};

&i2c0 {
	#address-cells = <1>;
	#size-cells = <0>;
	pinctrl-names = "default";
	pinctrl-0 = <&i2c0_pins_a>;
	status = "okay";

	bq25896_observe: charger@6b {
		compatible = "ti,bq25896", "ti,bq25890";
		reg = <0x6b>;
		ti,read-only;
		status = "okay";
	};
};
