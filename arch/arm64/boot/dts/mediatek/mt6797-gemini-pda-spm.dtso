// SPDX-License-Identifier: (GPL-2.0-only OR MIT)
/*
 * Planet Computers Gemini PDA: MT6797 SPM low-power program owner.
 *
 * Describes the SPM user that loads the vendor PCM scenario programs and
 * reports SPM power, CPU idle and CPU retention status.  It adds no CPU idle
 * states: the MT6797 firmware has no per-core power-down program, so a
 * PSCI power-down CPU_SUSPEND would never complete.
 */

/dts-v1/;
/plugin/;

/ {
	compatible = "planet,gemini-pda", "mediatek,mt6797";
};

&{/} {
	spm {
		compatible = "mediatek,mt6797-spm";
		mediatek,spm = <&scpsys>;
	};
};
